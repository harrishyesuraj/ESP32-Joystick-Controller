/*
 * ESP32 Game Controller  v2.1   (one analog stick + "+" of five buttons)
 * Developer: HARRISH YESURAJ P
 *
 * LAYOUT (see the architecture document)
 *   Left thumb : five buttons in a "+" : Up, Down, Left, Right, Center
 *   Right thumb: one analog stick (X, Y) with a click button
 *   Default game mapping:  + buttons = D-pad, Center = Select/View, stick = RIGHT stick, click = R3
 *   Any of the six controls can be re-assigned: Settings > Assign buttons
 *   (D-pad, face buttons A B X Y, LB RB LT RT, Select, Start, L3, R3, left-stick directions)
 *
 * MENU KEYS  (menus, lists and games)
 *   Up / Down = move     Right = open / OK     Left = back
 *   Stick click = OK     Center = back / pause
 *   Inside Bluetooth / USB the buttons go to the game; HOLD Center for 1.2 s to open the main menu.
 *
 * BLUETOOTH MODES  (Settings > Gamepad > Mode)
 *   Xbox (XInput)  : shows up as an Xbox controller - works in Windows games, Android, Mac, Linux
 *   Generic PC / Generic Android : plain HID gamepad (web testers, old setups)
 *   Changing between Xbox and Generic needs a restart and a fresh pairing (the board restarts itself).
 *
 * LIBRARIES : Adafruit GFX, Adafruit SSD1306, NimBLE-Arduino, ESP32-BLE-Gamepad 0.8.0 or newer
 *             (install the newest ZIP from github.com/lemmingDev/ESP32-BLE-Gamepad - it adds XInput mode)
 * BOARD     : "ESP32 Dev Module"
 *
 * PINS (from the circuit diagram)
 *   Stick  : VRx 34, VRy 35, SW 13      -> power the stick from 3V3, NOT 5V (ESP32 pins are not 5 V tolerant)
 *   Buttons: 27, 26, 25, 33, 32 (left to right in the diagram; Settings > Button positions sets which is Up/Down/...)
 *   OLED   : SCK 18, MOSI 23, RES 17, DC 16, CS 5          LED: GPIO2 via resistor
 */

#include <Arduino.h>
#include <SPI.h>
#include <Adafruit_GFX.h>
#include <Adafruit_SSD1306.h>
#include <Preferences.h>
#include <BleGamepad.h>
#include <stdarg.h>
#include <pgmspace.h>

// ============================== CONFIG ====================================
#define FW_VERSION      "v2.1"
#define SETTINGS_VER    4
#define DEV_NAME        "ESP32 Gamepad"
#define USE_XINPUT      1         // 1 = offer Xbox (XInput) mode. Set 0 if the compiler says 'GamepadMode' is unknown
                                  //     (then update the ESP32-BLE-Gamepad library to 0.8.0+).

#define DEADZONE        0.12f
#define NAV_ON          0.60f
#define NAV_OFF         0.40f
#define NAV_REPEAT_1    400
#define NAV_REPEAT_N    150
#define DEBOUNCE_MS     20
#define FRAME_MS        59        // drawing rate (~17 FPS)
#define HOST_MS         10        // gamepad report period
#define USB_TIMEOUT_MS  3000UL
#define MENU_HOLD_MS    1200      // hold Center on the Bluetooth / USB screen to open the menu

#define LOAD_FRAME_COUNT   6      // game-loading animation: 6 x 120 ms = 720 ms (>= 0.6 s)
#define LOAD_FRAME_MS      120
#define LEVELUP_FRAMES     32     // level-up animation
#define LEVELUP_FRAME_MS   55
#define LEVEL_METERS       100    // Dino: speed-up + level-up every 100 m
#define PX_PER_M           12

// ============================== PINS ======================================
#define SCREEN_W   128
#define SCREEN_H   64
#define OLED_SCK   18
#define OLED_MOSI  23
#define OLED_RESET 17
#define OLED_DC    16
#define OLED_CS     5
#define PIN_LED     2

uint8_t ADC_PIN[2] = { 34, 35 };                       // stick X, stick Y
// 0 Up, 1 Down, 2 Left, 3 Right, 4 Center, 5 stick click
uint8_t BTN_PIN[6] = { 27, 26, 25, 33, 32, 13 };
const uint8_t POS_CAND[5] = { 25, 26, 27, 32, 33 };    // pins of the five "+" buttons
#define B_UP     0
#define B_DOWN   1
#define B_LEFT   2
#define B_RIGHT  3
#define B_CENTER 4
#define B_CLICK  5
#define B_JUMP   B_UP        // Dino
#define B_DUCK   B_DOWN

// ============================== LOGO ======================================
// "PRESENTED BY PHY" logo, 128x64, 1 bit/pixel (from Refine.h, array renamed phy_logo)
const unsigned char phy_logo[] PROGMEM = {
  0x00, 0x00, 0x00, 0x00, 0x00, 0x00, 0x00, 0x00, 0x00, 0x00, 0x00, 0x00, 0x00, 0x00, 0x00, 0x00,
  0x00, 0x00, 0x00, 0x00, 0x18, 0x00, 0x00, 0x00, 0x00, 0x00, 0x00, 0x00, 0x00, 0x00, 0x00, 0x00,
  0x00, 0x00, 0x00, 0x00, 0x3F, 0x00, 0x00, 0x00, 0x00, 0x00, 0x00, 0x00, 0x00, 0x00, 0x00, 0x00,
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  0x00, 0x00, 0x00, 0x00, 0x00, 0x00, 0x00, 0x00, 0x00, 0x00, 0x00, 0x00, 0x00, 0x00, 0x00, 0x00,
};



// ---- Level-up animation: 32 frames (from goku-dragon-ball-level-up-anime-gif.h) ----
const uint8_t lvl_f0[1024] PROGMEM = {
  0x00, 0x00, 0x00, 0x00, 0x00, 0x00, 0x00, 0x00, 0x00, 0x00, 0x00, 0x00, 0x00, 0x00, 0x00, 0x00,
  0x00, 0x00, 0x00, 0x00, 0x00, 0x00, 0x00, 0x00, 0x00, 0x00, 0x00, 0x00, 0x00, 0x00, 0x00, 0x00,
  0x00, 0x00, 0x00, 0x00, 0x00, 0x00, 0x00, 0x00, 0x00, 0x00, 0x00, 0x00, 0x00, 0x00, 0x00, 0x00,
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  0x1B, 0xE0, 0x40, 0x10, 0x00, 0xF8, 0xE3, 0x0F, 0xE0, 0x78, 0x1F, 0xFF, 0xFF, 0x87, 0xFF, 0xC0,
};
const uint8_t lvl_f1[1024] PROGMEM = {
  0x00, 0x00, 0x00, 0x00, 0x00, 0x00, 0x00, 0x00, 0x00, 0x00, 0x00, 0x00, 0x00, 0x00, 0x00, 0x00,
  0x00, 0x00, 0x00, 0x00, 0x00, 0x00, 0x00, 0x00, 0x00, 0x00, 0x00, 0x00, 0x00, 0x00, 0x00, 0x00,
  0x00, 0x00, 0x00, 0x00, 0x00, 0x00, 0x00, 0x00, 0x00, 0x00, 0x00, 0x00, 0x00, 0x00, 0x00, 0x00,
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  0x9B, 0xE0, 0x40, 0x10, 0x00, 0xF8, 0xE3, 0x0F, 0xE0, 0x78, 0x1F, 0xFF, 0xFF, 0x87, 0xFF, 0xC0,
};
const uint8_t lvl_f2[1024] PROGMEM = {
  0x00, 0x00, 0x00, 0x00, 0x00, 0x00, 0x00, 0x00, 0x00, 0x00, 0x00, 0x00, 0x00, 0x00, 0x00, 0x00,
  0x00, 0x00, 0x00, 0x00, 0x00, 0x00, 0x00, 0x00, 0x00, 0x00, 0x00, 0x00, 0x00, 0x00, 0x00, 0x00,
  0x00, 0x00, 0x00, 0x00, 0x00, 0x00, 0x00, 0x00, 0x00, 0x00, 0x00, 0x00, 0x00, 0x00, 0x00, 0x00,
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  0x9B, 0xE0, 0x40, 0x10, 0x00, 0xF8, 0xE3, 0x0F, 0xE0, 0x78, 0x1F, 0xFF, 0xFF, 0x87, 0xFF, 0xC0,
};
const uint8_t lvl_f3[1024] PROGMEM = {
  0x00, 0x00, 0x00, 0x00, 0x00, 0x00, 0x00, 0x02, 0x20, 0x00, 0x00, 0x00, 0x00, 0x00, 0x00, 0x00,
  0x00, 0x00, 0x00, 0x00, 0x00, 0x00, 0x00, 0x02, 0x14, 0x00, 0x00, 0x00, 0x00, 0x00, 0x00, 0x00,
  0x00, 0x00, 0x00, 0x00, 0x00, 0x00, 0x00, 0x03, 0x18, 0x00, 0x00, 0x00, 0x00, 0x00, 0x00, 0x00,
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  0x1B, 0xE0, 0x40, 0x18, 0x00, 0xFC, 0x63, 0x0F, 0xE0, 0x78, 0x1F, 0xFF, 0xFF, 0x87, 0xFF, 0xC0,
};
const uint8_t lvl_f4[1024] PROGMEM = {
  0x00, 0x00, 0x00, 0x00, 0x00, 0x00, 0x00, 0x00, 0x00, 0x00, 0x00, 0x00, 0x00, 0x00, 0x00, 0x00,
  0x00, 0x00, 0x00, 0x00, 0x00, 0x00, 0x00, 0x70, 0x07, 0x80, 0x00, 0x00, 0x00, 0x00, 0x00, 0x00,
  0x00, 0x00, 0x00, 0x00, 0x00, 0x00, 0x00, 0xF8, 0x07, 0x00, 0x00, 0x00, 0x00, 0x00, 0x00, 0x00,
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  0x13, 0xE0, 0x40, 0x18, 0x00, 0xF8, 0x63, 0x0F, 0xE0, 0x78, 0x1F, 0xFF, 0xFF, 0x87, 0xFF, 0xC0,
};
const uint8_t lvl_f5[1024] PROGMEM = {
  0x00, 0x00, 0x00, 0x00, 0x00, 0x00, 0x00, 0x00, 0x00, 0x00, 0x00, 0x00, 0x00, 0x00, 0x00, 0x00,
  0x00, 0x00, 0x00, 0x00, 0x00, 0x00, 0x00, 0x00, 0x00, 0x00, 0x00, 0x00, 0x00, 0x00, 0x00, 0x00,
  0x00, 0x00, 0x00, 0x00, 0x00, 0x00, 0x00, 0x00, 0x00, 0x00, 0x00, 0x00, 0x00, 0x00, 0x00, 0x00,
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  0x13, 0xE0, 0x40, 0x10, 0x00, 0xFF, 0xE3, 0x4F, 0xE0, 0x78, 0x1F, 0xFF, 0xFF, 0x87, 0xFF, 0xC0,
};
const uint8_t lvl_f6[1024] PROGMEM = {
  0x00, 0x00, 0x00, 0x00, 0x00, 0x00, 0x00, 0x00, 0x00, 0x00, 0x00, 0x00, 0x00, 0x00, 0x00, 0x00,
  0x00, 0x00, 0x00, 0x00, 0x00, 0x00, 0x00, 0x00, 0x00, 0x00, 0x00, 0x00, 0x00, 0x00, 0x00, 0x00,
  0x00, 0x00, 0x00, 0x00, 0x00, 0x00, 0x00, 0x00, 0x00, 0x00, 0x00, 0x00, 0x00, 0x00, 0x00, 0x00,
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  0x13, 0xE0, 0x40, 0x10, 0x00, 0xFF, 0xE3, 0x4F, 0xE0, 0x78, 0x1F, 0xFF, 0xFF, 0x87, 0xFF, 0xC0,
};
const uint8_t lvl_f7[1024] PROGMEM = {
  0x00, 0x00, 0x01, 0xFF, 0x00, 0x00, 0x00, 0x00, 0x00, 0x03, 0x80, 0x06, 0x00, 0x00, 0x00, 0x00,
  0x00, 0x00, 0x00, 0xFF, 0xC0, 0x00, 0x00, 0x00, 0x00, 0x07, 0x80, 0x1C, 0x00, 0x00, 0x00, 0x00,
  0x00, 0x00, 0x00, 0x3F, 0xE0, 0x00, 0x00, 0x00, 0x00, 0x0F, 0x00, 0x30, 0x00, 0x00, 0x00, 0x00,
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  0x00, 0x00, 0x00, 0x00, 0x70, 0x00, 0x00, 0x00, 0x00, 0x00, 0x00, 0x00, 0xFF, 0xC0, 0x00, 0x00,
};
const uint8_t lvl_f8[1024] PROGMEM = {
  0xFF, 0xFF, 0xFF, 0xFF, 0xFF, 0xFD, 0xFF, 0xFF, 0xFF, 0xFF, 0xFF, 0xFF, 0xFF, 0xFF, 0xFF, 0xC0,
  0xFF, 0xFF, 0xFF, 0xFF, 0xFF, 0xFE, 0xFF, 0xFF, 0x7F, 0xFF, 0xFF, 0xFF, 0xFF, 0xFF, 0xFE, 0x00,
  0xFF, 0xFF, 0xFF, 0xFF, 0xFF, 0xFF, 0xFF, 0xFF, 0xFF, 0xFF, 0xFF, 0xFF, 0xFF, 0xFF, 0xF0, 0x00,
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  0xFF, 0xFF, 0xFF, 0x7F, 0xFF, 0xFF, 0xFF, 0xE7, 0xFF, 0xFF, 0xFF, 0xFF, 0xFF, 0xFF, 0xFF, 0xFF,
};
const uint8_t lvl_f9[1024] PROGMEM = {
  0x00, 0x00, 0x00, 0x00, 0x00, 0x40, 0x13, 0xFC, 0x73, 0xFF, 0xF0, 0x08, 0x00, 0x00, 0x00, 0x00,
  0x00, 0x00, 0x00, 0x00, 0x00, 0xC0, 0x17, 0xF9, 0xF0, 0xFF, 0xF0, 0x08, 0x00, 0x00, 0x00, 0x00,
  0x00, 0x00, 0x00, 0x00, 0x00, 0x40, 0x97, 0xF7, 0xFE, 0xFF, 0xF0, 0x08, 0x00, 0x00, 0x00, 0x00,
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  0x07, 0xE0, 0x60, 0x12, 0x00, 0xF8, 0xEC, 0x75, 0x30, 0x04, 0x0F, 0xFF, 0xFF, 0x87, 0xFF, 0xC0,
};
const uint8_t lvl_f10[1024] PROGMEM = {
  0x00, 0x00, 0x00, 0x00, 0x10, 0x78, 0xFF, 0xEC, 0x7F, 0x9F, 0xFF, 0x7C, 0x00, 0x00, 0x00, 0x00,
  0x00, 0x00, 0x00, 0x00, 0x14, 0x7C, 0xFE, 0x59, 0xFF, 0x9F, 0xFF, 0x7C, 0x00, 0x00, 0x00, 0x00,
  0x00, 0x00, 0x00, 0x01, 0x1E, 0x7C, 0xFE, 0x67, 0xF7, 0x0F, 0xFE, 0xF8, 0x00, 0x00, 0x00, 0x00,
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  0x07, 0xE0, 0x60, 0x12, 0x00, 0xF8, 0xFC, 0xFF, 0xC0, 0x00, 0x1F, 0xFF, 0xFF, 0x87, 0xFF, 0xC0,
};
const uint8_t lvl_f11[1024] PROGMEM = {
  0x00, 0x00, 0x18, 0x80, 0x0F, 0x30, 0x1F, 0xE1, 0xF0, 0xFE, 0x60, 0x7C, 0x7C, 0x00, 0x00, 0x00,
  0x00, 0x00, 0x32, 0x00, 0x07, 0x30, 0x1F, 0xC1, 0xF0, 0xFE, 0x40, 0xFF, 0x78, 0x00, 0x00, 0x00,
  0x00, 0x00, 0x36, 0x10, 0x07, 0x38, 0x3F, 0x87, 0xF8, 0xFF, 0xE0, 0x7E, 0xF8, 0x00, 0x00, 0x00,
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  0x07, 0xE0, 0x60, 0x12, 0x00, 0xF8, 0xE0, 0x4E, 0xE0, 0x00, 0x1F, 0xFF, 0xFF, 0x87, 0xFF, 0xC0,
};
const uint8_t lvl_f12[1024] PROGMEM = {
  0x00, 0x00, 0x00, 0x00, 0x98, 0x07, 0xF3, 0xF8, 0xE0, 0xFF, 0xFF, 0xFF, 0x60, 0x60, 0x00, 0x00,
  0x00, 0x01, 0x00, 0x00, 0xDC, 0x07, 0xF3, 0xFF, 0xF8, 0x7F, 0xFF, 0xFF, 0xE0, 0x60, 0x00, 0x00,
  0x00, 0x02, 0x00, 0x00, 0x7C, 0x0F, 0xE7, 0xF7, 0xE8, 0x7F, 0xE7, 0xF3, 0xF0, 0xE0, 0x00, 0x00,
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  0x07, 0xE0, 0x60, 0x12, 0x00, 0xF8, 0x00, 0x1F, 0x7E, 0x08, 0x1F, 0xFF, 0xFF, 0x87, 0xFF, 0xC0,
};
const uint8_t lvl_f13[1024] PROGMEM = {
  0x00, 0x80, 0x00, 0xE2, 0x04, 0x1E, 0x7F, 0xC1, 0xF3, 0xFF, 0xF0, 0x3F, 0xE0, 0x00, 0x18, 0x00,
  0x01, 0x80, 0x00, 0xE2, 0x06, 0x0E, 0x7F, 0x87, 0xF3, 0xFF, 0xF8, 0x3F, 0xE0, 0x08, 0x18, 0x00,
  0x01, 0x80, 0x00, 0xE0, 0x0F, 0x1C, 0x7F, 0x27, 0xFF, 0xFF, 0xF8, 0x7F, 0xE0, 0x08, 0x38, 0x00,
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  0x07, 0xE0, 0x60, 0x10, 0x00, 0x78, 0x0C, 0x7C, 0x00, 0x64, 0x1F, 0xFF, 0xFF, 0x87, 0xFF, 0xC0,
};
const uint8_t lvl_f14[1024] PROGMEM = {
  0x60, 0x00, 0x00, 0xE0, 0x01, 0x83, 0xFF, 0x41, 0xFF, 0xFF, 0xE3, 0xFF, 0x01, 0xFC, 0x00, 0x0C,
  0x40, 0x00, 0x00, 0x60, 0x01, 0x83, 0xFF, 0xFF, 0xF7, 0xFF, 0xE3, 0xFF, 0x01, 0xFC, 0x00, 0x0C,
  0x60, 0x00, 0x00, 0x20, 0x01, 0x87, 0xFF, 0xFF, 0xFF, 0xC7, 0xE3, 0xFF, 0x01, 0xFC, 0x00, 0x08,
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  0x07, 0xE0, 0x60, 0x10, 0x00, 0x78, 0x32, 0x0F, 0x08, 0x00, 0xDF, 0xFF, 0xFF, 0x87, 0xFF, 0xC0,
};
const uint8_t lvl_f15[1024] PROGMEM = {
  0x80, 0x00, 0x00, 0x40, 0x0C, 0xF5, 0xFF, 0xFF, 0xFF, 0xFF, 0x09, 0xFC, 0x00, 0x2F, 0xE0, 0x00,
  0x80, 0x00, 0x00, 0x00, 0x0C, 0xFF, 0xFF, 0xFD, 0xF8, 0x1F, 0x8B, 0xFC, 0x00, 0x6F, 0xE0, 0x00,
  0x80, 0x00, 0x00, 0x00, 0x0F, 0xFF, 0xFF, 0xE7, 0xF4, 0x07, 0x8F, 0xFE, 0x00, 0x6F, 0xE0, 0x02,
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  0x07, 0xE0, 0x60, 0x10, 0x00, 0x78, 0xC4, 0x70, 0xC7, 0x00, 0x1F, 0xFF, 0xFF, 0x87, 0xFF, 0x40,
};
const uint8_t lvl_f16[1024] PROGMEM = {
  0x00, 0x00, 0x00, 0x00, 0x18, 0xF3, 0xF7, 0xF8, 0x70, 0xFF, 0x01, 0xF9, 0x00, 0x63, 0xF0, 0x00,
  0x00, 0x00, 0x00, 0x00, 0x18, 0xFB, 0xF7, 0xC1, 0xF0, 0x3F, 0x03, 0xF8, 0x00, 0x63, 0xF0, 0x00,
  0x80, 0x00, 0x00, 0x00, 0x18, 0xFB, 0xFF, 0x87, 0xF0, 0x0F, 0x87, 0xFC, 0x80, 0xE3, 0xF0, 0x00,
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  0x07, 0xE0, 0x60, 0x10, 0x00, 0xFE, 0xE9, 0x8B, 0x83, 0x80, 0x1F, 0xFF, 0xFF, 0x87, 0xFF, 0x40,
};
const uint8_t lvl_f17[1024] PROGMEM = {
  0x00, 0x00, 0x00, 0x10, 0x00, 0x7C, 0xFB, 0xC0, 0x70, 0x3E, 0x0F, 0xF8, 0x20, 0xC0, 0x3E, 0x00,
  0x00, 0x00, 0x00, 0x00, 0x00, 0x7F, 0xFF, 0x81, 0xF0, 0x1E, 0x0F, 0xF8, 0x30, 0xC0, 0x3E, 0x00,
  0x00, 0x00, 0x00, 0x00, 0x01, 0x7F, 0xFF, 0x07, 0xFB, 0x1E, 0x1F, 0xF8, 0x33, 0xC0, 0x3E, 0x00,
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  0x07, 0xE0, 0x60, 0x10, 0x00, 0xF0, 0xE1, 0xF7, 0x83, 0xE0, 0x1F, 0xFF, 0xFF, 0x87, 0xFF, 0xC0,
};
const uint8_t lvl_f18[1024] PROGMEM = {
  0x00, 0x00, 0x00, 0x06, 0x00, 0x03, 0xFF, 0xC1, 0x6F, 0xFC, 0xFE, 0x01, 0x00, 0x1E, 0x00, 0x00,
  0x00, 0x00, 0x40, 0x00, 0x10, 0x03, 0xFF, 0xC5, 0xF3, 0xFF, 0xFE, 0x01, 0x00, 0x0E, 0x00, 0x00,
  0x00, 0x00, 0x40, 0x00, 0x18, 0x07, 0xFF, 0x87, 0xE9, 0xFF, 0xFE, 0x01, 0x00, 0x0C, 0x00, 0x00,
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  0x07, 0xE0, 0x60, 0x10, 0x00, 0xFF, 0xE0, 0xFF, 0x01, 0xF9, 0xDF, 0xFF, 0xFF, 0x87, 0xFF, 0xC0,
};
const uint8_t lvl_f19[1024] PROGMEM = {
  0x01, 0x00, 0x00, 0x00, 0x00, 0x00, 0x0F, 0xE0, 0xE0, 0x79, 0x01, 0x00, 0x00, 0x00, 0x00, 0x00,
  0x01, 0x00, 0x00, 0x00, 0x00, 0x02, 0x1F, 0xC7, 0xF8, 0x30, 0x01, 0x00, 0x00, 0x00, 0x00, 0x02,
  0x03, 0x00, 0x00, 0x00, 0x00, 0x0A, 0x1E, 0x87, 0xE8, 0x20, 0x01, 0x00, 0x00, 0x00, 0x00, 0x00,
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  0x07, 0xE0, 0x60, 0x10, 0x00, 0x7B, 0xFF, 0x8F, 0xFC, 0x08, 0x1F, 0xFF, 0xFF, 0x87, 0xFF, 0xC0,
};
const uint8_t lvl_f20[1024] PROGMEM = {
  0x00, 0x00, 0x00, 0x00, 0x00, 0x13, 0x47, 0xF9, 0xE0, 0x1E, 0x18, 0x00, 0x00, 0x00, 0x00, 0x00,
  0x00, 0x00, 0x00, 0x00, 0x00, 0x02, 0x63, 0xF9, 0xF0, 0x1E, 0x38, 0x00, 0x00, 0x00, 0x00, 0x00,
  0x00, 0x00, 0x00, 0x00, 0x00, 0x12, 0x47, 0xEF, 0xF8, 0x07, 0x34, 0x00, 0x00, 0x00, 0x00, 0x00,
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  0x07, 0xE0, 0x60, 0x10, 0x00, 0x7B, 0xF3, 0x0F, 0x00, 0xF8, 0x1F, 0xFF, 0xFF, 0x87, 0xFF, 0xC0,
};
const uint8_t lvl_f21[1024] PROGMEM = {
  0x00, 0x00, 0x00, 0x00, 0x00, 0x08, 0x0F, 0xE1, 0x70, 0x31, 0x01, 0x00, 0x00, 0x00, 0x00, 0x00,
  0x00, 0x00, 0x00, 0x00, 0x00, 0x02, 0x0F, 0xE1, 0xE0, 0xB1, 0x01, 0x00, 0x00, 0x00, 0x00, 0x00,
  0x00, 0x00, 0x00, 0x00, 0x00, 0x0A, 0x1E, 0x67, 0xF0, 0x11, 0x01, 0x00, 0x00, 0x00, 0x00, 0x00,
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  0x07, 0xE0, 0x60, 0x10, 0x00, 0xF0, 0x03, 0x0F, 0xC0, 0x70, 0x1F, 0xFF, 0xFF, 0x87, 0xFF, 0xC0,
};
const uint8_t lvl_f22[1024] PROGMEM = {
  0x00, 0x00, 0x00, 0x00, 0x00, 0x00, 0x02, 0x80, 0x70, 0x04, 0x00, 0x00, 0x00, 0x00, 0x00, 0x00,
  0x00, 0x00, 0x00, 0x00, 0x00, 0x00, 0x02, 0x81, 0xE0, 0x00, 0x00, 0x00, 0x00, 0x00, 0x00, 0x00,
  0x00, 0x00, 0x00, 0x00, 0x00, 0x10, 0x02, 0x07, 0xF4, 0x00, 0x04, 0x00, 0x00, 0x00, 0x00, 0x00,
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  0x07, 0xE0, 0x60, 0x10, 0x00, 0x78, 0xE3, 0x0F, 0xC0, 0x78, 0x1F, 0xFF, 0xFF, 0x87, 0xFF, 0x40,
};
const uint8_t lvl_f23[1024] PROGMEM = {
  0x00, 0x00, 0x00, 0x00, 0x00, 0x00, 0x08, 0xC0, 0xF0, 0x00, 0x01, 0x00, 0x00, 0x00, 0x00, 0x00,
  0x00, 0x00, 0x00, 0x00, 0x00, 0x00, 0x08, 0x05, 0xF0, 0x00, 0x01, 0x00, 0x00, 0x00, 0x00, 0x00,
  0x00, 0x00, 0x00, 0x00, 0x00, 0x00, 0x14, 0x06, 0xF8, 0x00, 0x01, 0x00, 0x00, 0x00, 0x00, 0x00,
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  0x07, 0xE0, 0x60, 0x10, 0x00, 0x78, 0xE3, 0x0F, 0xE0, 0xF8, 0x37, 0xFF, 0xFF, 0x87, 0xFE, 0x00,
};
const uint8_t lvl_f24[1024] PROGMEM = {
  0x00, 0x00, 0x00, 0x00, 0x00, 0x00, 0x08, 0xC0, 0xF0, 0x00, 0x01, 0x00, 0x00, 0x00, 0x00, 0x00,
  0x00, 0x00, 0x00, 0x00, 0x00, 0x00, 0x08, 0x05, 0xF0, 0x00, 0x01, 0x00, 0x00, 0x00, 0x00, 0x00,
  0x00, 0x00, 0x00, 0x00, 0x00, 0x00, 0x14, 0x06, 0xF8, 0x00, 0x01, 0x00, 0x00, 0x00, 0x00, 0x00,
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  0x07, 0xE0, 0x60, 0x10, 0x00, 0x78, 0xE3, 0x0F, 0xE0, 0xF8, 0x37, 0xFF, 0xFF, 0x87, 0xFE, 0x00,
};
const uint8_t lvl_f25[1024] PROGMEM = {
  0x00, 0x00, 0x00, 0x00, 0x00, 0x00, 0x08, 0xC0, 0x70, 0x00, 0x01, 0x00, 0x00, 0x00, 0x00, 0x00,
  0x00, 0x00, 0x00, 0x00, 0x00, 0x00, 0x08, 0x05, 0x00, 0x00, 0x01, 0x00, 0x00, 0x00, 0x00, 0x00,
  0x00, 0x00, 0x00, 0x00, 0x00, 0x00, 0x14, 0x00, 0x38, 0x00, 0x01, 0x00, 0x00, 0x00, 0x00, 0x00,
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  0x04, 0x00, 0x60, 0x10, 0x00, 0x00, 0x03, 0x0F, 0xE0, 0xF8, 0x35, 0x8F, 0xFF, 0x87, 0xFE, 0x00,
};
const uint8_t lvl_f26[1024] PROGMEM = {
  0x00, 0x00, 0x00, 0x00, 0x00, 0x00, 0x08, 0xC0, 0x70, 0x00, 0x01, 0x00, 0x00, 0x00, 0x00, 0x00,
  0x00, 0x00, 0x00, 0x00, 0x00, 0x00, 0x08, 0x05, 0x00, 0x00, 0x01, 0x00, 0x00, 0x00, 0x00, 0x00,
  0x00, 0x00, 0x00, 0x00, 0x00, 0x00, 0x14, 0x00, 0x00, 0x00, 0x01, 0x00, 0x00, 0x00, 0x00, 0x00,
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  0x04, 0x00, 0x00, 0x00, 0x00, 0x00, 0x03, 0x00, 0x00, 0x00, 0x34, 0x03, 0xE0, 0x87, 0x90, 0x00,
};
const uint8_t lvl_f27[1024] PROGMEM = {
  0x00, 0x00, 0x00, 0x00, 0x00, 0x00, 0x00, 0x00, 0x30, 0x00, 0x00, 0x00, 0x00, 0x00, 0x00, 0x00,
  0x00, 0x00, 0x00, 0x00, 0x00, 0x00, 0x00, 0x00, 0x00, 0x00, 0x00, 0x00, 0x00, 0x00, 0x00, 0x00,
  0x00, 0x00, 0x00, 0x00, 0x00, 0x00, 0x00, 0x00, 0x00, 0x00, 0x01, 0x00, 0x00, 0x00, 0x00, 0x00,
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  0x04, 0x00, 0x00, 0x00, 0x00, 0x00, 0x03, 0x00, 0x00, 0x00, 0x30, 0x03, 0xE0, 0x87, 0x90, 0x00,
};
const uint8_t lvl_f28[1024] PROGMEM = {
  0x00, 0x00, 0x00, 0x00, 0x00, 0x00, 0x00, 0x00, 0x30, 0x00, 0x00, 0x00, 0x00, 0x00, 0x00, 0x00,
  0x00, 0x00, 0x00, 0x00, 0x00, 0x00, 0x00, 0x00, 0x00, 0x00, 0x00, 0x00, 0x00, 0x00, 0x00, 0x00,
  0x00, 0x00, 0x00, 0x00, 0x00, 0x00, 0x00, 0x00, 0x00, 0x00, 0x01, 0x00, 0x00, 0x00, 0x00, 0x00,
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  0x04, 0x00, 0x00, 0x00, 0x00, 0x00, 0x00, 0x00, 0x00, 0x00, 0x00, 0x00, 0x00, 0x04, 0x00, 0x00,
};
const uint8_t lvl_f29[1024] PROGMEM = {
  0x00, 0x00, 0x00, 0x00, 0x00, 0x00, 0x00, 0x00, 0x30, 0x00, 0x00, 0x00, 0x00, 0x00, 0x00, 0x00,
  0x00, 0x00, 0x00, 0x00, 0x00, 0x00, 0x00, 0x00, 0x00, 0x00, 0x00, 0x00, 0x00, 0x00, 0x00, 0x00,
  0x00, 0x00, 0x00, 0x00, 0x00, 0x00, 0x00, 0x00, 0x00, 0x00, 0x01, 0x00, 0x00, 0x00, 0x00, 0x00,
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  0x00, 0x00, 0x00, 0x00, 0x00, 0x00, 0x00, 0x00, 0x00, 0x00, 0x00, 0x00, 0x00, 0x00, 0x00, 0x00,
};
const uint8_t lvl_f30[1024] PROGMEM = {
  0x00, 0x00, 0x00, 0x00, 0x00, 0x00, 0x00, 0x00, 0x00, 0x00, 0x00, 0x00, 0x00, 0x00, 0x00, 0x00,
  0x00, 0x00, 0x00, 0x00, 0x00, 0x00, 0x00, 0x00, 0x00, 0x00, 0x00, 0x00, 0x00, 0x00, 0x00, 0x00,
  0x00, 0x00, 0x00, 0x00, 0x00, 0x00, 0x00, 0x00, 0x00, 0x00, 0x00, 0x00, 0x00, 0x00, 0x00, 0x00,
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  0x00, 0x00, 0x00, 0x00, 0x00, 0x00, 0x00, 0x00, 0x00, 0x00, 0x00, 0x00, 0x00, 0x00, 0x00, 0x00,
};
const uint8_t lvl_f31[1024] PROGMEM = {
  0x00, 0x00, 0x00, 0x00, 0x00, 0x00, 0x00, 0x00, 0x00, 0x00, 0x00, 0x00, 0x00, 0x00, 0x00, 0x00,
  0x00, 0x00, 0x00, 0x00, 0x00, 0x00, 0x00, 0x00, 0x00, 0x00, 0x00, 0x00, 0x00, 0x00, 0x00, 0x00,
  0x00, 0x00, 0x00, 0x00, 0x00, 0x00, 0x00, 0x00, 0x00, 0x00, 0x00, 0x00, 0x00, 0x00, 0x00, 0x00,
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  0x00, 0x00, 0x00, 0x00, 0x00, 0x00, 0x00, 0x00, 0x00, 0x00, 0x00, 0x00, 0x00, 0x00, 0x00, 0x00,
};
const uint8_t* const LVL_FRAMES[] PROGMEM = { lvl_f0, lvl_f1, lvl_f2, lvl_f3, lvl_f4, lvl_f5, lvl_f6, lvl_f7, lvl_f8, lvl_f9, lvl_f10, lvl_f11, lvl_f12, lvl_f13, lvl_f14, lvl_f15, lvl_f16, lvl_f17, lvl_f18, lvl_f19, lvl_f20, lvl_f21, lvl_f22, lvl_f23, lvl_f24, lvl_f25, lvl_f26, lvl_f27, lvl_f28, lvl_f29, lvl_f30, lvl_f31 };

// ---- Game-loading animation: 6 frames x 120 ms (from the Super Saiyan sketch) ----
const uint8_t ld_f0[1024] PROGMEM = {
  0x00, 0x00, 0x00, 0x00, 0x00, 0x3F, 0xBF, 0xDC, 0xC3, 0xFF, 0xE0, 0x3C, 0x00, 0x00, 0x00, 0x00,
  0x00, 0x00, 0x00, 0x00, 0x00, 0x7F, 0xFF, 0xD8, 0xE1, 0xFF, 0xE0, 0x78, 0x00, 0x00, 0x00, 0x00,
  0x00, 0x00, 0x00, 0x00, 0x00, 0x7F, 0xFF, 0xE0, 0x60, 0xFF, 0xC0, 0xF8, 0x00, 0x00, 0x00, 0x00,
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  0x00, 0x00, 0x00, 0x01, 0x80, 0x00, 0x00, 0x00, 0x00, 0x00, 0x00, 0x00, 0x00, 0x00, 0x00, 0x00,
};
const uint8_t ld_f1[1024] PROGMEM = {
  0x00, 0x00, 0x00, 0x00, 0x30, 0x43, 0xFF, 0x00, 0x03, 0xFF, 0x07, 0xC0, 0x00, 0x00, 0x00, 0x00,
  0x00, 0x00, 0x00, 0x00, 0x10, 0x63, 0xFF, 0x00, 0x01, 0xFF, 0x0F, 0xC0, 0x00, 0x00, 0x00, 0x00,
  0x00, 0x00, 0x00, 0x00, 0x18, 0x79, 0xFF, 0x00, 0x00, 0xFF, 0x9F, 0xC0, 0x00, 0x00, 0x00, 0x00,
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  0x00, 0x00, 0x00, 0x03, 0x80, 0x00, 0x00, 0x00, 0x00, 0x00, 0x00, 0x00, 0x00, 0x00, 0x00, 0x00,
};
const uint8_t ld_f2[1024] PROGMEM = {
  0x00, 0x00, 0x00, 0x00, 0x01, 0xE3, 0xFF, 0x00, 0x03, 0xFF, 0xFE, 0x00, 0x00, 0x00, 0x00, 0x00,
  0x00, 0x00, 0x00, 0x00, 0x01, 0xF3, 0xFF, 0x00, 0x01, 0xFF, 0xFE, 0x00, 0x00, 0x00, 0x00, 0x00,
  0x00, 0x00, 0x00, 0x00, 0x01, 0xFB, 0xFE, 0x00, 0x00, 0xFF, 0xFE, 0x00, 0x40, 0x00, 0x00, 0x00,
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  0x00, 0x00, 0x00, 0x03, 0x80, 0x00, 0x00, 0x00, 0x00, 0x00, 0x00, 0x00, 0x00, 0x00, 0x00, 0x00,
};
const uint8_t ld_f3[1024] PROGMEM = {
  0x00, 0x00, 0x00, 0x00, 0x00, 0x3F, 0xBF, 0xDC, 0x83, 0xFF, 0xE0, 0x7C, 0x00, 0x00, 0x00, 0x00,
  0x00, 0x00, 0x00, 0x00, 0x00, 0x7F, 0xFF, 0xD8, 0xE1, 0xFF, 0xE0, 0x78, 0x00, 0x00, 0x00, 0x00,
  0x00, 0x00, 0x00, 0x00, 0x00, 0x7F, 0xFF, 0xF0, 0x60, 0xFF, 0xC0, 0xF8, 0x00, 0x00, 0x00, 0x00,
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  0x00, 0x00, 0x00, 0x01, 0x80, 0x00, 0x00, 0x00, 0x00, 0x00, 0x00, 0x00, 0x00, 0x00, 0x00, 0x00,
};
const uint8_t ld_f4[1024] PROGMEM = {
  0x00, 0x00, 0x00, 0x00, 0x30, 0x43, 0xFF, 0x80, 0x03, 0xFF, 0x07, 0xC0, 0x00, 0x00, 0x00, 0x00,
  0x00, 0x00, 0x00, 0x00, 0x10, 0x63, 0xFF, 0x00, 0x01, 0xFF, 0x0F, 0xC0, 0x00, 0x00, 0x00, 0x00,
  0x00, 0x00, 0x00, 0x00, 0x18, 0x79, 0xFF, 0x00, 0x00, 0xFF, 0x9F, 0xC0, 0x00, 0x00, 0x00, 0x00,
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  0x00, 0x00, 0x00, 0x01, 0x80, 0x00, 0x00, 0x00, 0x00, 0x00, 0x00, 0x00, 0x00, 0x00, 0x00, 0x00,
};
const uint8_t ld_f5[1024] PROGMEM = {
  0x00, 0x00, 0x00, 0x00, 0x01, 0xE3, 0xFF, 0x80, 0x03, 0xFF, 0xFE, 0x00, 0x00, 0x00, 0x00, 0x00,
  0x00, 0x00, 0x00, 0x00, 0x01, 0xF3, 0xFF, 0x00, 0x01, 0xFF, 0xFE, 0x00, 0x20, 0x00, 0x00, 0x00,
  0x00, 0x00, 0x00, 0x00, 0x01, 0xFB, 0xFE, 0x00, 0x00, 0xFF, 0xFE, 0x00, 0x40, 0x00, 0x00, 0x00,
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  0x00, 0x00, 0x00, 0x01, 0x80, 0x00, 0x00, 0x00, 0x00, 0x00, 0x00, 0x00, 0x00, 0x00, 0x00, 0x00,
};
const uint8_t* const LD_FRAMES[] PROGMEM = { ld_f0, ld_f1, ld_f2, ld_f3, ld_f4, ld_f5 };

// ============================== TYPES =====================================
enum BtState : uint8_t { BT_WAIT, BT_CONN };
enum LinkMode : uint8_t { LINK_NONE, LINK_BT, LINK_USB };

enum Scr : uint8_t {
  SC_MENU, SC_GAMES, SC_HOME_BT, SC_HOME_USB, SC_LINKTEST,
  SC_SETTINGS, SC_PADMODE, SC_CALMENU, SC_CAL, SC_ORIENT, SC_POS, SC_MAPLIST, SC_MAPEDIT, SC_MONITOR,
  SC_DISPLAY, SC_LED, SC_SYSTEM, SC_ABOUT, SC_CONFIRM, SC_LOADING, SC_LEVELUP,
  SC_DINO_START, SC_DINO_PLAY, SC_DINO_PAUSE, SC_DINO_OVER,
  SC_PAC_START, SC_PAC_PLAY, SC_PAC_PAUSE, SC_PAC_OVER,
  SC_SNAKE_START, SC_SNAKE_PLAY, SC_SNAKE_PAUSE, SC_SNAKE_OVER
};

enum Ev : uint8_t { EV_UP = 1, EV_DOWN, EV_LEFT, EV_RIGHT, EV_OK, EV_BACK, EV_MODE };

struct Cal { int16_t mn[2]; int16_t ct[2]; int16_t mx[2]; };
struct Orient { uint8_t src[2]; int8_t sgn[2]; };      // logical X,Y -> ADC channel + sign
struct Config {
  uint8_t  map[6];     // game button for: Up Down Left Right Center StickClick (see TGT_NAME)
  uint8_t  bri;        // 1..5
  uint8_t  tmo;        // 0 Off, 1 30s, 2 1m, 3 5m
  uint8_t  led;        // 0 Off, 1 On, 2 Status, 3 Activity
  uint8_t  pad;        // 0 Xbox (XInput), 1 Generic PC, 2 Generic Android
  uint8_t  yinv;       // 1 = invert the stick's Y axis for the game
  uint32_t hi;         // Dino best distance (m)
  uint32_t phi;        // Pac-Man best score
  uint32_t shi;        // Snake best score
};
struct GameDef { const char* name; Scr startScr; uint32_t* hi; };

// ============================== GLOBALS ===================================
Adafruit_SSD1306 display(SCREEN_W, SCREEN_H, &SPI, OLED_DC, OLED_RESET, OLED_CS);
Preferences prefs;
BleGamepad bleGamepad(DEV_NAME, "ESP32", 100);
bool bleStarted = false; uint8_t bleMode = 0;          // bleMode = pad mode the Bluetooth stack was started with

Config cfg;
Cal    cal, tcal;
bool   calValid = false;
Orient ori; bool oriSet = false;
bool   hiCentre = false;                               // stick centre reads high: probably powered from 5 V

const uint8_t  CONTRAST[5]   = { 26, 64, 128, 191, 255 };
const uint32_t TIMEOUT_MS[4] = { 0, 30000UL, 60000UL, 300000UL };
const char* const TMO_NAME[4] = { "Off", "30s", "1m", "5m" };
const uint8_t  TMO_CELLS[4]  = { 0, 3, 6, 10 };
const char* const LED_NAME[4] = { "Off", "On", "Status", "Activity" };

// ---- game buttons a physical control can be assigned to ----
// 1..12 are real buttons, 13..16 the D-pad (hat), 17..20 the LEFT stick directions (full tilt)
const char* const TGT_NAME[21] = { "None", "A", "B", "X", "Y", "LB", "RB", "LT", "RT", "Select", "Start", "L3", "R3",
                                   "D-pad Up", "D-pad Down", "D-pad Left", "D-pad Right",
                                   "L-stick Up", "L-stick Down", "L-stick Left", "L-stick Right" };
const char* const SHORT_TGT[21] = { "-", "A", "B", "X", "Y", "LB", "RB", "LT", "RT", "Se", "St", "L3", "R3",
                                    "^", "v", "<", ">", "L^", "Lv", "L<", "L>" };
const uint8_t XB_BTN[13]  = { 0, 1, 2, 3, 4, 5, 6, 0, 0, 9, 10, 7, 8 };           // Xbox mode: LT/RT are analog triggers
const uint8_t HID_PC[13]  = { 0, 1, 2, 3, 4, 5, 6, 7, 8, 9, 10, 11, 12 };          // Generic PC (Windows / web testers)
const uint8_t HID_AND[13] = { 0, 1, 2, 4, 5, 7, 8, 9, 10, 11, 12, 14, 15 };        // Generic Android
const char* const PAD_NAME[3] = { "Xbox", "Generic PC", "Android" };
const char* const PAD_TAG[3]  = { "XB", "PC", "AND" };
const char* const PAD_HINT[3] = { "Best for PC games", "Web testers, old apps", "Plain HID on Android" };
// layouts: Up Down Left Right Center StickClick
const uint8_t PRESET[3][6] = { { 13, 14, 15, 16, 9, 12 },     // D-pad:  D-pad, Select, R3
                               {  4,  1,  3,  2, 9, 12 },     // Face buttons: Y A X B
                               {  8,  7, 19, 20, 9, 12 } };   // Racing: Up=RT gas, Down=LT brake, Left/Right = steer
const char* const PRESET_NAME[4] = { "D-pad", "Face btns", "Racing", "Custom" };
const uint8_t DEF_MAP[6] = { 13, 14, 15, 16, 9, 12 };
const char* const CTL_NAME[6] = { "Up button", "Down button", "Left button", "Right button", "Center button", "Stick click" };

// ---- ADD NEW GAMES HERE: name, first screen, pointer to its saved best score ----
const GameDef GAMES[] = {
  { "Dino Run", SC_DINO_START, &cfg.hi  },
  { "Pac-Man",  SC_PAC_START,  &cfg.phi },
  { "Snake",    SC_SNAKE_START, &cfg.shi },
};
const uint8_t GAME_COUNT = sizeof(GAMES) / sizeof(GAMES[0]);

const char* const MENU_NAMES[5] = { "Bluetooth", "USB", "Games", "Settings", "About" };
const char* const SET_NAMES[9]  = { "Calibration", "Gamepad", "Assign buttons", "Button positions", "Input monitor", "Display", "LED", "Link test", "System" };
const char* const SYS_NAMES[3]  = { "Reset mapping", "Reset high scores", "Factory reset" };
const char* const CAL_NAMES[3]  = { "Calibrate range", "Orientation", "Reset calibration" };

// inputs
int   rawAx[2];
float ax[2];                 // stick: right = +, down = +  (up = -)
bool  btn[6];
uint32_t btnT[6];
bool  pressEdge[6], relEdge[6];

// events
uint8_t evq[10]; uint8_t evn = 0;
bool     navAct[4]; uint32_t navNext[4];
bool     menuHold = false, menuFired = false, menuSwallow = false;
uint32_t menuT = 0;

// screens
Scr  scr = SC_MENU, retScr = SC_MENU, loadTarget = SC_MENU, lvReturn = SC_MENU;
bool displayOn = true, needRedraw = true;
uint32_t lastAct = 0, lastFrame = 0, ledActUntil = 0, loadT0 = 0, lvT0 = 0, testT0 = 0;

// link (Bluetooth / USB)
LinkMode linkMode = LINK_NONE;
BtState  btState = BT_WAIT;
uint32_t usbLastMsg = 0;
bool     usbConn = false;
uint32_t lastMask = 0, lastHidMask = 0; int8_t lastQ[2] = { 0, 0 };
uint32_t lastHostT = 0, lastUsbT = 0, txCount = 0, lastTxVis = 0;

// menu state
uint8_t selMenu = 0, selGame = 0, selSet = 0, selCal = 0, selMap = 0, selSys = 0, selConf = 0, dispRow = 0, padRow = 0, mapTmp = 0, confKind = 0;
uint32_t okHoldT = 0;
bool needRestart = false;

bool calWarn = false;

// ----- Dino -----
#define GROUND_Y 60
#define DINO_X   10
#define GRAV     500.0f           // low gravity = floaty, long jump
#define JUMP_V   190.0f           // peak ~36 px, ~0.76 s in the air
struct Obs { bool on; uint8_t type; float x; };
Obs   obs[3];
const uint8_t OW[4] = { 6, 10, 15, 12 };
const uint8_t OH[4] = { 12, 16, 12, 8 };
#define BIRD_BOT 11
float    dinoH = 0, dinoV = 0, gameSpeed = 60, nextGap = 80, distM = 0;
bool     ducking = false, newHi = false;
uint32_t score = 0, dinoLevel = 0, overT = 0, animMs = 0;

// ============================== HELPERS ===================================
void P(uint8_t r, uint8_t c, const char* f, ...) {
  char b[40]; va_list a; va_start(a, f); vsnprintf(b, sizeof b, f, a); va_end(a);
  display.setCursor(c * 6, r * 8); display.print(b);
}
void PR(uint8_t r, const char* s) {                 // right aligned
  display.setCursor((21 - strlen(s)) * 6, r * 8); display.print(s);
}
void PCtr(int y, const char* s, uint8_t sz) {       // centred, pixel y
  int w = strlen(s) * 6 * sz;
  display.setTextSize(sz); display.setCursor((SCREEN_W - w) / 2, y); display.print(s);
  display.setTextSize(1);
}
void header(const char* t, const char* right) {
  display.fillRect(0, 0, 128, 8, WHITE); display.setTextColor(BLACK);
  P(0, 0, "%s", t); if (right) PR(0, right);
  display.setTextColor(WHITE);
}
void footer(const char* s) { P(7, 0, "%s", s); }
void itemY(int y, int x0, int w, const char* s, const char* val, bool sel) {
  if (sel) { display.fillRect(x0, y, w, 8, WHITE); display.setTextColor(BLACK); }
  display.setCursor(x0 + 2, y); display.print(sel ? ">" : " "); display.print(" "); display.print(s);
  if (val) { display.setCursor(x0 + w - 2 - strlen(val) * 6, y); display.print(val); }
  display.setTextColor(WHITE);
}
void item(uint8_t r, const char* s, const char* val, bool sel) { itemY(r * 8, 0, 128, s, val, sel); }
void cellBar(int x, int y, int filled, int total, int cw, int ch) {
  for (int i = 0; i < total; i++) {
    if (i < filled) display.fillRect(x + i * (cw + 1), y, cw, ch, WHITE);
    else            display.drawRect(x + i * (cw + 1), y, cw, ch, WHITE);
  }
}
// Nokia-style menu: one boxed list, up to 5 rows, vertical scroll bar on the right
void drawBoxList(const char* const* names, uint8_t n, uint8_t sel, const char* const* vals) {
  display.drawRect(0, 9, 128, 44, WHITE);
  const int vis = 5; int top = sel < vis ? 0 : sel - vis + 1;
  for (int k = 0; k < vis && top + k < n; k++)
    itemY(10 + k * 8, 2, 116, names[top + k], vals ? vals[top + k] : NULL, top + k == sel);
  int th = 40 / n; if (th < 6) th = 6; if (th > 40) th = 40;
  int ty = n > 1 ? 10 + (40 - th) * sel / (n - 1) : 10;
  display.drawFastVLine(122, 10, 40, WHITE);          // track
  display.fillRect(120, ty, 5, th, WHITE);            // thumb
}
void drawStickBox(int x, int y, float sx, float sy, int sz = 32) {
  display.drawRect(x, y, sz, sz, WHITE);
  int h = sz / 2, r = h - 3;
  display.fillRect(x + h + (int)(sx * r) - 1, y + h + (int)(sy * r) - 1, 3, 3, WHITE);
}
// elapsed ms, never negative (timestamps taken inside a loop pass can be newer than the pass's 'now')
static inline uint32_t since(uint32_t now, uint32_t t) { return (int32_t)(now - t) < 0 ? 0 : now - t; }
void setContrast(uint8_t v) { display.ssd1306_command(SSD1306_SETCONTRAST); display.ssd1306_command(v); }
void applyBrightness() { setContrast(CONTRAST[constrain(cfg.bri, 1, 5) - 1]); }
void setLed(bool on) { static int8_t last = -1; if (last != (int8_t)on) { digitalWrite(PIN_LED, on); last = on; } }

// ============================== SETTINGS ==================================
void defaultsConfig() { memcpy(cfg.map, DEF_MAP, 6); cfg.bri = 4; cfg.tmo = 2; cfg.led = 2; cfg.pad = USE_XINPUT ? 0 : 1; cfg.yinv = 0; cfg.hi = 0; cfg.phi = 0; cfg.shi = 0; }
void defaultsCal() { for (int i = 0; i < 2; i++) { cal.mn[i] = 0; cal.ct[i] = 2048; cal.mx[i] = 4095; } }
void defaultsOri() { for (int i = 0; i < 2; i++) { ori.src[i] = i; ori.sgn[i] = 1; } }
void saveMap()     { prefs.putBytes("map", cfg.map, 6); }
void saveDisplay() { prefs.putUChar("bri", cfg.bri); prefs.putUChar("tmo", cfg.tmo); }
void saveLedCfg()  { prefs.putUChar("led", cfg.led); }
void savePad()     { prefs.putUChar("pad", cfg.pad); prefs.putUChar("yinv", cfg.yinv); }
void saveHi()      { prefs.putUInt("hi", cfg.hi); }
void savePhi()     { prefs.putUInt("phi", cfg.phi); }
void saveShi()     { prefs.putUInt("shi", cfg.shi); }
void saveCal()     { prefs.putBytes("cal", &cal, sizeof(cal)); }
void saveOri()     { prefs.putBytes("ori", &ori, sizeof(ori)); }
void savePins()    { prefs.putBytes("bpin", BTN_PIN, 5); }

bool inList(uint8_t p, const uint8_t* l, int n) { for (int i = 0; i < n; i++) if (l[i] == p) return true; return false; }
void applyPins() {
  for (int i = 0; i < 5; i++) pinMode(POS_CAND[i], INPUT);
  for (int i = 0; i < 6; i++) pinMode(BTN_PIN[i], INPUT_PULLUP);
  for (int i = 0; i < 2; i++) pinMode(ADC_PIN[i], INPUT);
}
bool rdBtn(uint8_t i) { return digitalRead(BTN_PIN[i]) == LOW; }
void loadPins() {                                       // positions chosen in Settings > Button positions
  uint8_t b[5];
  if (prefs.getBytesLength("bpin") != 5) return;
  prefs.getBytes("bpin", b, 5);
  for (int i = 0; i < 5; i++) { if (!inList(b[i], POS_CAND, 5)) return; for (int j = i + 1; j < 5; j++) if (b[i] == b[j]) return; }
  memcpy(BTN_PIN, b, 5);
}

void loadSettings() {
  prefs.begin("ctrl", false);
  defaultsConfig(); defaultsCal(); defaultsOri(); calValid = false; oriSet = false;
  uint8_t ver = prefs.getUChar("ver", 0);
  if (ver == 0 || ver > SETTINGS_VER) {                 // first start / unknown layout
    prefs.clear(); prefs.putUChar("ver", SETTINGS_VER);
    saveMap(); saveDisplay(); saveLedCfg(); savePad(); saveHi(); savePhi(); saveShi();
    return;
  }
  if (prefs.getBytesLength("map") == 6) prefs.getBytes("map", cfg.map, 6);
  cfg.bri = prefs.getUChar("bri", 4);
  cfg.tmo = prefs.getUChar("tmo", 2);
  cfg.led = prefs.getUChar("led", 2);
  cfg.pad = prefs.getUChar("pad", USE_XINPUT ? 0 : 1);
  cfg.yinv = prefs.getUChar("yinv", 0);
  cfg.hi  = prefs.getUInt("hi", 0);
  cfg.phi = prefs.getUInt("phi", 0);
  cfg.shi = prefs.getUInt("shi", 0);
  if (prefs.getBytesLength("cal") == sizeof(cal)) { prefs.getBytes("cal", &cal, sizeof(cal)); calValid = true; }
  if (prefs.getBytesLength("ori") == sizeof(ori)) {
    Orient o; prefs.getBytes("ori", &o, sizeof(o));
    if (o.src[0] < 2 && o.src[1] < 2 && o.src[0] != o.src[1] && (o.sgn[0] == 1 || o.sgn[0] == -1) && (o.sgn[1] == 1 || o.sgn[1] == -1)) { ori = o; oriSet = true; }
  }
  loadPins();
  if (ver < 4) {                                        // new architecture: new controls, new defaults
    memcpy(cfg.map, DEF_MAP, 6); cfg.pad = USE_XINPUT ? 0 : 1; cfg.yinv = 0; saveMap(); savePad();
    prefs.remove("pins"); prefs.putUChar("ver", SETTINGS_VER);
  }
  for (int i = 0; i < 6; i++) if (cfg.map[i] > 20) cfg.map[i] = DEF_MAP[i];
  if (cfg.pad > 2 || (!USE_XINPUT && cfg.pad == 0)) cfg.pad = USE_XINPUT ? 0 : 1;
  cfg.bri = constrain(cfg.bri, 1, 5); if (cfg.tmo > 3) cfg.tmo = 2; if (cfg.led > 3) cfg.led = 2; if (cfg.yinv > 1) cfg.yinv = 0;
}

bool xboxMode() { return USE_XINPUT && cfg.pad == 0; }
uint8_t presetIndex() {                                  // 0 D-pad, 1 Face, 2 Racing, 3 Custom
  for (int p = 0; p < 3; p++) { bool same = true; for (int i = 0; i < 6; i++) if (cfg.map[i] != PRESET[p][i]) same = false; if (same) return p; }
  return 3;
}

// ============================== INPUT =====================================
// median of 7 reads (after 3 dummy reads to flush the ADC multiplexer) removes spikes and channel crosstalk
int readAdc(uint8_t pin) {
  analogRead(pin); analogRead(pin); analogRead(pin);
  int v[7];
  for (int i = 0; i < 7; i++) v[i] = analogRead(pin);
  for (int i = 1; i < 7; i++) { int k = v[i], j = i - 1; while (j >= 0 && v[j] > k) { v[j + 1] = v[j]; j--; } v[j + 1] = k; }
  return v[3];
}
float filt[2]; bool filtInit = false;

// normalised -1..1 for one ADC channel, sign = raw direction (below / above centre)
float chNorm(const Cal& c, uint8_t ch, int raw) {
  float v;
  if (raw >= c.ct[ch]) { float sp = c.mx[ch] - c.ct[ch]; v = sp > 50 ? (raw - c.ct[ch]) / sp : 0; }
  else                 { float sp = c.ct[ch] - c.mn[ch]; v = sp > 50 ? -(float)(c.ct[ch] - raw) / sp : 0; }
  v = constrain(v, -1.0f, 1.0f);
  float a = fabsf(v);
  if (a < DEADZONE) return 0;
  a = (a - DEADZONE) / (1.0f - DEADZONE);
  return v < 0 ? -a : a;
}
// logical axis (0 X, 1 Y): right = +, down = + (up = -), using the learned orientation
float logAxis(const Cal& c, uint8_t L) { uint8_t ch = ori.src[L]; return chNorm(c, ch, rawAx[ch]) * ori.sgn[L]; }

void pushEv(uint8_t e) { if (evn < sizeof(evq)) evq[evn++] = e; }

bool linkScreen() { return scr == SC_HOME_BT || scr == SC_HOME_USB; }
// list-like screens: Right button = OK, Left button = Back
bool listScreen() {
  switch (scr) {
    case SC_MENU: case SC_GAMES: case SC_SETTINGS: case SC_CALMENU: case SC_MAPLIST: case SC_SYSTEM: case SC_ABOUT:
    case SC_CONFIRM: case SC_CAL: case SC_ORIENT:
    case SC_DINO_START: case SC_DINO_PAUSE: case SC_DINO_OVER: case SC_PAC_START: case SC_PAC_PAUSE: case SC_PAC_OVER: case SC_LEVELUP:
    case SC_SNAKE_START: case SC_SNAKE_PAUSE: case SC_SNAKE_OVER:
      return true;
    default: return false;
  }
}
// screens where the stick moves the menu cursor
bool stickNavScreen() {
  switch (scr) {
    case SC_HOME_BT: case SC_HOME_USB: case SC_LINKTEST: case SC_CAL: case SC_ORIENT: case SC_POS: case SC_MONITOR:
    case SC_DINO_PLAY: case SC_PAC_PLAY: case SC_SNAKE_PLAY: case SC_LOADING: case SC_LEVELUP: return false;
    default: return true;
  }
}
// screens where the stick click is OK
bool clickOkScreen() {
  switch (scr) {
    case SC_HOME_BT: case SC_HOME_USB: case SC_LINKTEST: case SC_CAL: case SC_POS:
    case SC_DINO_PLAY: case SC_PAC_PLAY: case SC_SNAKE_PLAY: case SC_LOADING: return false;
    default: return true;
  }
}

void navStep(uint8_t d, float val, uint8_t ev, uint32_t now) {
  if (!navAct[d]) {
    if (val > NAV_ON) { navAct[d] = true; navNext[d] = now + NAV_REPEAT_1; pushEv(ev); }
  } else {
    if (val < NAV_OFF) navAct[d] = false;
    else if (now >= navNext[d]) { navNext[d] = now + NAV_REPEAT_N; pushEv(ev); }
  }
}

bool readInputs(uint32_t now) {
  bool act = false;
  for (int i = 0; i < 2; i++) {
    int m = readAdc(ADC_PIN[i]);
    if (!filtInit) filt[i] = m; else filt[i] += (m - filt[i]) * 0.30f;
    rawAx[i] = (int)(filt[i] + 0.5f);
  }
  filtInit = true;
  for (int L = 0; L < 2; L++) { ax[L] = logAxis(cal, L); if (ax[L] != 0) act = true; }
  for (int i = 0; i < 6; i++) {
    pressEdge[i] = relEdge[i] = false;
    bool raw = rdBtn(i);
    if (raw != btn[i] && now - btnT[i] >= DEBOUNCE_MS) {       // accept at once, then lock out 20 ms
      btn[i] = raw; btnT[i] = now;
      if (raw) { pressEdge[i] = true; act = true; } else relEdge[i] = true;
    }
  }
  return act;
}

void genEvents(uint32_t now) {
  evn = 0;
  bool lst = listScreen();
  if (stickNavScreen()) {
    navStep(0, -ax[1], EV_UP,    now);
    navStep(1,  ax[1], EV_DOWN,  now);
    navStep(2, -ax[0], EV_LEFT,  now);
    navStep(3,  ax[0], EV_RIGHT, now);
  }
  if (pressEdge[B_UP])    pushEv(EV_UP);
  if (pressEdge[B_DOWN])  pushEv(EV_DOWN);
  if (pressEdge[B_LEFT])  pushEv(lst ? EV_BACK : EV_LEFT);
  if (pressEdge[B_RIGHT]) pushEv(lst ? EV_OK : EV_RIGHT);
  if (pressEdge[B_CLICK] && clickOkScreen()) pushEv(EV_OK);
  if (pressEdge[B_CENTER] && !linkScreen()) pushEv(EV_BACK);

  // hold Center on the Bluetooth / USB screen = main menu (the press itself still goes to the game)
  if (pressEdge[B_CENTER]) { menuHold = true; menuFired = false; menuT = now; menuSwallow = !displayOn; }
  if (menuHold) {
    if (!btn[B_CENTER]) menuHold = false;
    else if (!menuFired && since(now, menuT) >= MENU_HOLD_MS && linkScreen() && !menuSwallow) { menuFired = true; pushEv(EV_MODE); }
  }
}

// ============================== BLUETOOTH / USB ===========================
void startBle() {
  if (bleStarted) return;
  BleGamepadConfiguration c;
#if USE_XINPUT
  if (cfg.pad == 0) {
    c.setGamepadMode(GamepadMode::XInputSeriesX);          // Xbox controller: set FIRST, it overwrites other settings
    c.setAutoReport(false);
    bleGamepad.begin(&c);
    bleStarted = true; bleMode = 0; return;
  }
#endif
  c.setAutoReport(false);
  c.setControllerType(CONTROLLER_TYPE_GAMEPAD);
  c.setVid(0xe502); c.setPid(0xabcd);
  c.setButtonCount(15);                                    // Android numbering needs up to 15
  c.setHatSwitchCount(1);                                  // the D-pad
  c.setWhichAxes(true, true, true, true, false, true, false, false);  // X Y Z RX RZ
  c.setAxesMin(0);
  c.setAxesMax(32767);
  bleGamepad.begin(&c);
  bleGamepad.setX(16383); bleGamepad.setY(16383); bleGamepad.setZ(16383); bleGamepad.setRX(16383); bleGamepad.setRZ(16383);
  bleStarted = true; bleMode = cfg.pad;
}
bool padNeedsRestart() { return bleStarted && ((bleMode == 0) != (cfg.pad == 0)); }   // Xbox <-> Generic changes the HID descriptor

// bit (t-1) = game button t:  1 A,2 B,3 X,4 Y,5 LB,6 RB,7 LT,8 RT,9 Select,10 Start,11 L3,12 R3,
//                              13-16 D-pad U/D/L/R, 17-20 left-stick U/D/L/R
uint32_t padMask() {
  uint32_t m = 0;
  for (int c = 0; c < 6; c++) if (btn[c] && cfg.map[c]) m |= (1UL << (cfg.map[c] - 1));
  return m;
}
uint8_t hatFrom(uint32_t m) {                              // 0 centred, 1 N, 2 NE, 3 E, 4 SE, 5 S, 6 SW, 7 W, 8 NW
  bool u = m & (1UL << 12), d = m & (1UL << 13), l = m & (1UL << 14), r = m & (1UL << 15);
  if (u && d) { u = d = false; } if (l && r) { l = r = false; }
  if (u) return r ? 2 : (l ? 8 : 1);
  if (d) return r ? 4 : (l ? 6 : 5);
  return r ? 3 : (l ? 7 : 0);
}
void btSend(uint32_t sm, int qx, int qy) {
  bool xb = (bleMode == 0) && USE_XINPUT;                  // the descriptor that is really running
  uint16_t hm = 0;
  for (int t = 1; t <= 12; t++) if (sm & (1UL << (t - 1))) {
    uint8_t n = xb ? XB_BTN[t] : (cfg.pad == 2 ? HID_AND[t] : HID_PC[t]);
    if (n) hm |= (1u << (n - 1));
  }
  for (int n = 1; n <= 15; n++) {
    bool want = hm & (1u << (n - 1)), had = lastHidMask & (1u << (n - 1));
    if (want && !had) bleGamepad.press(n);
    if (!want && had) bleGamepad.release(n);
  }
  lastHidMask = hm;
  int lx = ((sm >> 19) & 1) - ((sm >> 18) & 1), ly = ((sm >> 17) & 1) - ((sm >> 16) & 1);
  uint8_t hat = hatFrom(sm);
#if USE_XINPUT
  if (xb) {
    bleGamepad.setTriggers((sm & (1UL << 6)) ? 32767 : 0, (sm & (1UL << 7)) ? 32767 : 0);
    bleGamepad.setHat(hat);
    bleGamepad.setLeftThumb(lx * 32767, ly * 32767);
    bleGamepad.setRightThumb(qx * 520, qy * 520);          // 63 steps * 520 = full scale
    bleGamepad.sendReport();
    return;
  }
#endif
  bleGamepad.setHat1(hat);
  bleGamepad.setX(16383 + lx * 16383); bleGamepad.setY(16383 + ly * 16383);                // left stick (from buttons)
  bleGamepad.setZ(16383 + qx * 260);                                                      // right stick X
  if (cfg.pad == 1) { bleGamepad.setRX(16383 + qy * 260); bleGamepad.setRZ(16383); }       // PC: right stick Y on Rx
  else              { bleGamepad.setRZ(16383 + qy * 260); bleGamepad.setRX(16383); }       // Android: Rz
  bleGamepad.sendReport();
}
void padChanged() {                                        // layout/platform changed: release everything on the host
  if (bleStarted && !padNeedsRestart()) {
    for (int n = 1; n <= 15; n++) bleGamepad.release(n);
    btSend(0, 0, 0);
  }
  lastHidMask = 0; lastMask = 0; lastQ[0] = 99;
}

int quant(float v) { int s = (int)lroundf(v * 63.0f); return s > 63 ? 63 : (s < -63 ? -63 : s); }

// One frame to the active link. Sends on change (button changes at once, stick at most 40/s) and as a
// keep-alive (Bluetooth 100 ms, USB 500 ms) so a host that subscribes late still gets the current state.
void txFrame(uint32_t mask, int qx, int qy, uint32_t now) {
  bool btnCh = (mask != lastMask), axCh = (qx != lastQ[0] || qy != lastQ[1]);
  if (linkMode == LINK_BT) {
    if (!bleStarted || btState != BT_CONN) return;
    if (btnCh)       { if (now - lastHostT < 5)  return; }
    else if (axCh)   { if (now - lastHostT < 25) return; }
    else if (now - lastHostT < 100) return;
    btSend(mask, qx, qy); lastHostT = now;
  } else if (linkMode == LINK_USB) {
    if ((btnCh || axCh) ? (now - lastUsbT < HOST_MS) : (now - lastUsbT < 500)) return;
    Serial.printf("$,%d,%d,%lu\n", qx * 1000 / 63, qy * 1000 / 63, (unsigned long)mask);
    lastUsbT = now;
  } else return;
  lastMask = mask; lastQ[0] = qx; lastQ[1] = qy;
  txCount++; lastTxVis = now;
}

// automatic Link-test pattern: stick circles, then every game button in turn
void testState(uint32_t t, int& qx, int& qy, uint32_t& mask, int& sem) {
  float ang = t / 1500.0f * 6.2832f;
  qx = quant(cosf(ang) * 0.9f); qy = quant(sinf(ang) * 0.9f);
  int slot = (t / 500) % 21; sem = slot < 20 ? slot + 1 : 0;
  mask = sem ? (1UL << (sem - 1)) : 0;
}

void sendHost(uint32_t now) {
  if (linkMode == LINK_NONE) return;
  if (scr == SC_LINKTEST) { int qx, qy, sem; uint32_t m; testState(now - testT0, qx, qy, m, sem); txFrame(m, qx, qy, now); return; }
  bool home = (scr == SC_HOME_BT && linkMode == LINK_BT) || (scr == SC_HOME_USB && linkMode == LINK_USB);
  if (home) { int qy = quant(ax[1]) * (cfg.yinv ? -1 : 1); txFrame(padMask(), quant(ax[0]), qy, now); return; }
  if (lastMask != 0 || lastQ[0] != 0 || lastQ[1] != 0) txFrame(0, 0, 0, now);        // left the link screen: release everything once
}

void updateLink(uint32_t now) {
  if (bleStarted) {
    bool c = bleGamepad.isConnected();
    if (c && btState != BT_CONN) { btState = BT_CONN; lastMask = 0; lastHidMask = 0; lastQ[0] = 99; }   // force a full report
    else if (!c && btState == BT_CONN) { btState = BT_WAIT; lastMask = 0; }
  }
  if (linkMode == LINK_USB) {
    while (Serial.available()) { Serial.read(); usbLastMsg = now; }
    usbConn = usbLastMsg && (now - usbLastMsg < USB_TIMEOUT_MS);
  }
}

// ============================== SCREEN CONTROL ============================
void gotoScr(Scr s) {
  scr = s; needRedraw = true; lastAct = millis();
  if (s == SC_CONFIRM) { selConf = 0; okHoldT = 0; }
  if (s == SC_DISPLAY) dispRow = 0;
  if (s == SC_SYSTEM)  selSys = 0;
  if (s == SC_LINKTEST) testT0 = millis();
}
void afterBoot() { gotoScr(SC_MENU); }
void openMenu() { retScr = scr; gotoScr(SC_MENU); }
void startLoading(Scr target) { loadTarget = target; loadT0 = millis(); gotoScr(SC_LOADING); }
void startLevelUp(Scr ret) { lvReturn = ret; lvT0 = millis(); gotoScr(SC_LEVELUP); }
void openBt() {
  startBle(); linkMode = LINK_BT; lastMask = 0; lastQ[0] = 99;
  btState = bleGamepad.isConnected() ? BT_CONN : BT_WAIT;
  gotoScr(SC_HOME_BT);
}
void openUsb() { linkMode = LINK_USB; usbLastMsg = 0; usbConn = false; lastMask = 0; lastQ[0] = 99; gotoScr(SC_HOME_USB); }

void sleepDisplay() { display.ssd1306_command(SSD1306_DISPLAYOFF); displayOn = false; }
void wakeDisplay()  { display.ssd1306_command(SSD1306_DISPLAYON);  displayOn = true; needRedraw = true; }

// ============================== CALIBRATION ===============================
// Settings > Calibration > Calibrate range: sweep the stick, watch the box.
//   Up button = set centre (stick released)   Down button = restart range   Right = save   Center = cancel
#define CAL_REACH 1100
void applyCentreC(Cal& c, int i, int v, bool resetRange) {
  c.ct[i] = v;
  if (resetRange) { c.mn[i] = c.mx[i] = v; return; }
  if (c.mn[i] > v - 100) c.mn[i] = v > 1500 ? v - 1500 : 0;       // keep ordering sane
  if (c.mx[i] < v + 100) c.mx[i] = v < 2595 ? v + 1500 : 4095;
}
// averages 80 samples per channel (~0.4 s); optionally also returns the noise (max-min) per channel
void calMeasureCentre(int out[2], int noise[2] = NULL) {
  long sum[2] = { 0, 0 }; int mn[2] = { 4095, 4095 }, mx[2] = { 0, 0 };
  for (int k = 0; k < 80; k++) {
    for (int i = 0; i < 2; i++) { int v = readAdc(ADC_PIN[i]); sum[i] += v; if (v < mn[i]) mn[i] = v; if (v > mx[i]) mx[i] = v; }
    delay(5);
  }
  for (int i = 0; i < 2; i++) { out[i] = sum[i] / 80; if (noise) noise[i] = mx[i] - mn[i]; }
}
void softCentre(bool resetRange) {          // quiet re-centre of the active calibration (reset)
  int c[2]; calMeasureCentre(c);
  for (int i = 0; i < 2; i++) {
    if (resetRange) { cal.ct[i] = c[i]; cal.mn[i] = c[i] > 1700 ? c[i] - 1700 : 0; cal.mx[i] = c[i] < 2395 ? c[i] + 1700 : 4095; }
    else applyCentreC(cal, i, c[i], false);
  }
  hiCentre = (c[0] > 2700 || c[1] > 2700);
}
int needL(int i) { int a = (int)(tcal.ct[i] * 0.7f);          return a < CAL_REACH ? a : CAL_REACH; }
int needR(int i) { int a = (int)((4095 - tcal.ct[i]) * 0.7f); return a < CAL_REACH ? a : CAL_REACH; }
float progL(int i) { int n = needL(i); if (n < 50) return 1; float v = (tcal.ct[i] - tcal.mn[i]) / (float)n; return v > 1 ? 1 : v; }
float progR(int i) { int n = needR(i); if (n < 50) return 1; float v = (tcal.mx[i] - tcal.ct[i]) / (float)n; return v > 1 ? 1 : v; }
int calPct(int i) { float p = progL(i) < progR(i) ? progL(i) : progR(i); return (int)(p * 100); }

void calCentreNow(bool resetRange) {
  int c[2]; calMeasureCentre(c);
  for (int i = 0; i < 2; i++) applyCentreC(tcal, i, c[i], resetRange);
  hiCentre = (c[0] > 2700 || c[1] > 2700);
  calWarn = false;
}
void calEnter() { tcal = cal; calCentreNow(!calValid); gotoScr(SC_CAL); }
void calExit()   { gotoScr(SC_CALMENU); }
void calCancel() { gotoScr(SC_CALMENU); }
void calTrack() {
  for (int i = 0; i < 2; i++) {
    if (rawAx[i] < tcal.mn[i]) tcal.mn[i] = rawAx[i];
    if (rawAx[i] > tcal.mx[i]) tcal.mx[i] = rawAx[i];
  }
}
void calSave() {
  bool low = false; for (int i = 0; i < 2; i++) if (calPct(i) < 50) low = true;
  if (low && !calWarn) { calWarn = true; needRedraw = true; return; }   // first OK warns, second OK saves anyway
  cal = tcal; saveCal(); calValid = true; calExit();
}

// ---- Orientation: push the stick UP, DOWN, LEFT, RIGHT; whatever you push defines the directions ----
uint8_t oStep = 0, oPhase = 0; int oRest[2], oNoise[2]; uint32_t oT = 0, oAt = 0;
int8_t oCh[4], oSg[4]; bool oPass = false; char oMsg[22];
const char* const O_DIR[4] = { "UP", "DOWN", "LEFT", "RIGHT" };

void oriEvaluate() {
  oPass = true; oMsg[0] = 0;
  int chU = oCh[0], sU = oSg[0], chD = oCh[1], sD = oSg[1], chL = oCh[2], sL = oSg[2], chR = oCh[3], sR = oSg[3];
  if (chU != chD || sU == sD)      { oPass = false; snprintf(oMsg, 22, "UP/DOWN differ"); }
  else if (chL != chR || sL == sR) { oPass = false; snprintf(oMsg, 22, "LEFT/RIGHT differ"); }
  else if (chU == chR)             { oPass = false; snprintf(oMsg, 22, "X and Y same wire"); }
  else { ori.src[0] = chR; ori.sgn[0] = sR; ori.src[1] = chU; ori.sgn[1] = -sU; oriSet = true; saveOri(); }
}
void oriStart() {
  calMeasureCentre(oRest, oNoise);
  oStep = 0; oPhase = 0; oT = millis(); oAt = 0; oPass = false;
  gotoScr(SC_ORIENT);
}
void oriTick(uint32_t now) {
  if (oStep >= 4) return;
  int da = rawAx[0] - oRest[0], db = rawAx[1] - oRest[1];
  int tha = 3 * oNoise[0] > 900 ? 3 * oNoise[0] : 900, thb = 3 * oNoise[1] > 900 ? 3 * oNoise[1] : 900;
  if (oPhase == 0) {                                   // wait until the stick is released
    if (abs(da) < tha / 3 && abs(db) < thb / 3) { if (!oAt) oAt = now; if (since(now, oAt) >= 300) { oPhase = 1; oAt = 0; needRedraw = true; } }
    else oAt = 0;
  } else if (oPhase == 1) {                            // wait for a clear push
    if (abs(da) >= tha || abs(db) >= thb) {
      if (!oAt) oAt = now;
      if (since(now, oAt) >= 120) {
        bool useA = (long)abs(da) * thb >= (long)abs(db) * tha;
        int ch = useA ? 0 : 1, dev = useA ? da : db;
        oCh[oStep] = ch; oSg[oStep] = dev > 0 ? 1 : -1;
        oPhase = 2; oT = now; oAt = 0; needRedraw = true;
      }
    } else oAt = 0;
  } else if (since(now, oT) >= 500) {                  // show "got it" briefly, next direction
    oStep++; oPhase = 0; oAt = 0; needRedraw = true;
    if (oStep >= 4) oriEvaluate();
  }
}

// ---- Button positions: press Up, Down, Left, Right, Center in turn (which of the 5 wired buttons is which) ----
const char* const POS_NAME[5] = { "UP", "DOWN", "LEFT", "RIGHT", "CENTER" };
uint8_t posStep = 0, posPhase = 0; uint8_t posPin[5]; uint32_t posT = 0, posAt = 0, posCancelT = 0, posLowT[5]; bool posDone = false;

void posStart() {
  for (int i = 0; i < 5; i++) { pinMode(POS_CAND[i], INPUT_PULLUP); posPin[i] = 255; posLowT[i] = 0; }
  posStep = 0; posPhase = 0; posDone = false; posT = millis(); posAt = 0; posCancelT = 0;
  gotoScr(SC_POS);
}
void posApply() { for (int i = 0; i < 5; i++) BTN_PIN[i] = posPin[i]; savePins(); applyPins(); }
void posTick(uint32_t now) {
  if (posDone) {                                       // all five learned: ANY "+" button saves, the stick click cancels
    if (since(now, posT) < 700) return;                // ignore the release of the last press
    for (int i = 0; i < 5; i++) if (pressEdge[i]) { posApply(); gotoScr(SC_SETTINGS); return; }
    if (pressEdge[B_CLICK]) { applyPins(); gotoScr(SC_SETTINGS); }
    return;
  }
  if (btn[B_CLICK]) { if (!posCancelT) posCancelT = now; else if (since(now, posCancelT) >= 2000) { applyPins(); gotoScr(SC_SETTINGS); return; } } else posCancelT = 0;   // hold the stick click to cancel
  if (posPhase == 0) {                                 // wait until all five are released
    bool anyLow = false; for (int i = 0; i < 5; i++) if (digitalRead(POS_CAND[i]) == LOW) anyLow = true;
    if (anyLow) posT = now; else if (since(now, posT) >= 400) { posPhase = 1; needRedraw = true; }
  } else if (posPhase == 1) {                          // wait for a press on a pin not used yet
    for (int i = 0; i < 5; i++) {
      bool used = false; for (int j = 0; j < posStep; j++) if (posPin[j] == POS_CAND[i]) used = true;
      if (used) continue;
      if (digitalRead(POS_CAND[i]) == LOW) {
        if (!posLowT[i]) posLowT[i] = now;
        if (since(now, posLowT[i]) >= 40) { posPin[posStep] = POS_CAND[i]; posPhase = 2; posT = now; needRedraw = true; break; }
      } else posLowT[i] = 0;
    }
  } else if (posPhase == 2) {
    if (since(now, posT) >= 600) { posPhase = 3; posAt = 0; needRedraw = true; }
  } else {                                             // wait for release, then next
    bool anyLow = false; for (int i = 0; i < 5; i++) if (digitalRead(POS_CAND[i]) == LOW) anyLow = true;
    if (anyLow) posAt = 0;
    else {
      if (!posAt) posAt = now;
      if (since(now, posAt) >= 200) {
        posStep++; posAt = 0; posPhase = 1; needRedraw = true;
        for (int i = 0; i < 5; i++) posLowT[i] = 0;
        if (posStep >= 5) { posDone = true; posT = now; }
      }
    }
  }
}

// ============================== DINO GAME =================================
void startGame() {
  for (auto& o : obs) o.on = false;
  dinoH = dinoV = 0; ducking = false; score = 0; distM = 0; dinoLevel = 0; newHi = false;
  gameSpeed = 60; nextGap = 80; animMs = 0;
  gotoScr(SC_DINO_PLAY);
}
void gameOver() {
  newHi = score > cfg.hi;
  if (newHi) { cfg.hi = score; saveHi(); }
  overT = millis(); gotoScr(SC_DINO_OVER);
}
void gameInput() {                      // every loop pass: low-latency jump/duck
  bool up = btn[B_JUMP] || ax[1] < -0.5f, dn = btn[B_DUCK] || ax[1] > 0.5f;
  bool ground = (dinoH <= 0.01f && dinoV <= 0);
  if (up && ground) { dinoV = JUMP_V; dinoH = 0.5f; }
  ducking = dn && ground;
}
void gameStep(float dt) {
  if (dt > 0.1f) dt = 0.1f;
  animMs += (uint32_t)(dt * 1000.0f + 0.5f);
  if (dinoH > 0 || dinoV > 0) {
    bool dn = btn[B_DUCK] || ax[1] > 0.5f;
    dinoV -= GRAV * (dn ? 2.0f : 1.0f) * dt; dinoH += dinoV * dt;
    if (dinoH <= 0) { dinoH = 0; dinoV = 0; }
  }
  uint32_t lvl = dinoLevel > 10 ? 10 : dinoLevel;
  gameSpeed = 60 + 8 * lvl;                          // faster every 100 m
  distM += gameSpeed * dt / PX_PER_M; score = (uint32_t)distM;
  if (score >= (dinoLevel + 1) * LEVEL_METERS) {     // crossed 100 m, 200 m ...
    dinoLevel++;
    for (auto& o : obs) o.on = false;                // clear the track after the animation
    nextGap = 90;
    startLevelUp(SC_DINO_PLAY);
    return;
  }

  float rightmost = -1000; bool any = false;
  for (auto& o : obs) if (o.on) {
    o.x -= gameSpeed * dt;
    if (o.x + OW[o.type] < 0) o.on = false;
    else { any = true; float re = o.x + OW[o.type]; if (re > rightmost) rightmost = re; }
  }
  if (!any || (128 - rightmost) >= nextGap) {
    for (auto& o : obs) if (!o.on) {
      o.on = true; o.x = 128;
      o.type = (dinoLevel >= 1 && random(100) < 30) ? 3 : random(3);
      nextGap = random(80, 140) + gameSpeed * 0.5f;
      break;
    }
  }
  // collision
  float dx1, dx2, dB = dinoH, dT;
  if (ducking) { dx1 = DINO_X + 1; dx2 = DINO_X + 15; dT = dB + 9; }
  else         { dx1 = DINO_X + 4; dx2 = DINO_X + 11; dT = dB + 13; }
  for (auto& o : obs) if (o.on) {
    float ox1 = o.x + 1, ox2 = o.x + OW[o.type] - 1;
    float oB = (o.type == 3) ? BIRD_BOT : 0, oT = oB + OH[o.type];
    if (dx1 < ox2 && dx2 > ox1 && dB < oT && dT > oB) { gameOver(); return; }
  }
}

// ---- Dino drawing ----
void drawDino(int x, int yBottom, bool duck, bool run) {
  bool f = run && ((animMs / 120) % 2);
  if (!duck) {
    int y = yBottom - 16;
    display.fillRect(x + 6, y, 8, 6, WHITE);              // head
    display.drawPixel(x + 11, y + 1, BLACK);              // eye
    display.fillRect(x + 11, y + 4, 3, 1, BLACK);         // mouth
    display.fillRect(x + 3, y + 6, 9, 6, WHITE);          // body
    display.fillRect(x, y + 6, 3, 3, WHITE);              // tail
    display.fillRect(x + 12, y + 9, 2, 1, WHITE);         // arm
    display.fillRect(x + 4, y + 12, 2, f ? 4 : 2, WHITE); // legs
    display.fillRect(x + 9, y + 12, 2, f ? 2 : 4, WHITE);
  } else {
    int y = yBottom - 9;
    display.fillRect(x + 10, y, 7, 5, WHITE);             // head
    display.drawPixel(x + 14, y + 1, BLACK);
    display.fillRect(x, y + 3, 12, 4, WHITE);             // body
    display.fillRect(x + 2, y + 7, 2, f ? 2 : 1, WHITE);
    display.fillRect(x + 8, y + 7, 2, f ? 1 : 2, WHITE);
  }
}
void drawCactus(int x, int w, int h) {
  int y = GROUND_Y - h;
  display.fillRect(x + w / 2 - 1, y, 3, h, WHITE);
  display.fillRect(x, y + 4, 2, 5, WHITE);  display.fillRect(x, y + 8, w / 2, 1, WHITE);
  if (w >= 10) { display.fillRect(x + w - 2, y + 3, 2, 5, WHITE); display.fillRect(x + w / 2 + 1, y + 7, w / 2 - 1, 1, WHITE); }
}
void drawBird(int x, int bottomH) {
  int y = GROUND_Y - bottomH - 8;
  display.fillRect(x + 2, y + 3, 8, 3, WHITE);
  display.fillRect(x + 9, y + 2, 3, 3, WHITE); display.drawPixel(x + 12, y + 3, WHITE);
  display.drawPixel(x, y + 4, WHITE);
  if ((animMs / 150) % 2) display.fillRect(x + 4, y, 3, 3, WHITE); else display.fillRect(x + 4, y + 6, 3, 2, WHITE);
}
// ============================== PAC-MAN ===================================
#define PAC_W  21
#define PAC_H  9
#define PT     6            // tile size in pixels
#define PAC_OX 1
#define PAC_OY 10
const char* const PAC_MAZE[PAC_H] = {
  "#####################",
  "#o....#.......#....o#",
  "#.##.##.##.##.##.##.#",
  "#...................#",
  "#.#...#.#...#.#...#.#",
  "#...................#",
  "#.##.##.##.##.##.##.#",
  "#o....#.......#....o#",
  "#####################"
};
struct Ent { int8_t tx, ty, dx, dy; float p; };
Ent pac, gh[2];
bool ghFr[2];
uint32_t ghRel[2], pacT = 0, frightEnd = 0, freezeUntil = 0, pacScore = 0, pacOverT = 0;
uint8_t  pacCell[PAC_H][PAC_W];            // 0 empty, 1 dot, 2 pellet, 9 wall
uint16_t dotsLeft = 0;
uint8_t  pacLives = 3, pacLevel = 1;
int8_t   wantX = 0, wantY = 0, faceX = 1, faceY = 0;
bool     pacNewHi = false;
const int8_t GSX[2] = { 1, 19 }, GSY[2] = { 1, 1 };
const int8_t DX4[4] = { 0, 0, -1, 1 }, DY4[4] = { -1, 1, 0, 0 };

bool pFree(int x, int y) { return x >= 0 && x < PAC_W && y >= 0 && y < PAC_H && pacCell[y][x] != 9; }

void pacLoadMaze() {
  dotsLeft = 0;
  for (int y = 0; y < PAC_H; y++) for (int x = 0; x < PAC_W; x++) {
    char c = PAC_MAZE[y][x];
    uint8_t v = (c == '#') ? 9 : (c == '.' ? 1 : (c == 'o' ? 2 : 0));
    if (v == 1 || v == 2) dotsLeft++;
    pacCell[y][x] = v;
  }
  if (pacCell[7][10]) { pacCell[7][10] = 0; dotsLeft--; }   // Pac-Man start tile
}
void ghostHome(int g) { gh[g].tx = GSX[g]; gh[g].ty = GSY[g]; gh[g].dx = gh[g].dy = 0; gh[g].p = 0; ghFr[g] = false; }
void pacResetPos() {
  pac.tx = 10; pac.ty = 7; pac.dx = pac.dy = 0; pac.p = 0; wantX = wantY = 0; faceX = 1; faceY = 0;
  for (int g = 0; g < 2; g++) { ghostHome(g); ghRel[g] = pacT + 1500 + g * 2000; }
  frightEnd = 0;
}
void startPac() {
  pacScore = 0; pacLives = 3; pacLevel = 1; pacNewHi = false; pacT = 0;
  pacLoadMaze(); pacResetPos(); freezeUntil = 1200;
  gotoScr(SC_PAC_PLAY);
}
void pacOver() {
  pacNewHi = pacScore > cfg.phi;
  if (pacNewHi) { cfg.phi = pacScore; savePhi(); }
  pacOverT = millis(); gotoScr(SC_PAC_OVER);
}

void ghostChoose(int g) {
  Ent& e = gh[g];
  bool fr = ghFr[g] && pacT < frightEnd;
  int8_t cx[4], cy[4]; int n = 0;
  for (int d = 0; d < 4; d++) {
    if (!pFree(e.tx + DX4[d], e.ty + DY4[d])) continue;
    if ((e.dx || e.dy) && DX4[d] == -e.dx && DY4[d] == -e.dy) continue;   // no U-turns
    cx[n] = DX4[d]; cy[n] = DY4[d]; n++;
  }
  if (n == 0) {
    if (pFree(e.tx - e.dx, e.ty - e.dy) && (e.dx || e.dy)) { e.dx = -e.dx; e.dy = -e.dy; }
    else e.dx = e.dy = 0;
    return;
  }
  int pick = 0;
  if (fr || random(100) < 20) pick = random(n);
  else {
    int best = 9999;
    for (int k = 0; k < n; k++) {
      int dd = abs(e.tx + cx[k] - pac.tx) + abs(e.ty + cy[k] - pac.ty);
      if (dd < best) { best = dd; pick = k; }
    }
  }
  e.dx = cx[pick]; e.dy = cy[pick];
}

// returns true when the maze was cleared
bool pacEat() {
  uint8_t& c = pacCell[pac.ty][pac.tx];
  if (c == 1) { pacScore += 10; dotsLeft--; c = 0; }
  else if (c == 2) {
    pacScore += 50; dotsLeft--; c = 0;
    uint32_t len = 6000; uint32_t cut = 400UL * (pacLevel - 1); len = (len > cut + 2500) ? len - cut : 2500;
    frightEnd = pacT + len; ghFr[0] = ghFr[1] = true;
  }
  if (dotsLeft == 0) {
    pacLevel++; pacLoadMaze(); pacResetPos(); freezeUntil = pacT + 1000;
    return true;
  }
  return false;
}

void pacStep(float dt) {
  pacT += (uint32_t)(dt * 1000.0f + 0.5f);
  if (pacT < freezeUntil) return;

  // desired direction: Joystick 1 (dominant axis), or B1 up / B2 down
  int wx = 0, wy = 0;
  if (fabsf(ax[0]) > 0.5f || fabsf(ax[1]) > 0.5f) {
    if (fabsf(ax[0]) > fabsf(ax[1])) wx = ax[0] > 0 ? 1 : -1; else wy = ax[1] > 0 ? 1 : -1;
  } else if (btn[B_UP]) wy = -1;
  else if (btn[B_DOWN]) wy = 1;
  else if (btn[B_LEFT]) wx = -1;
  else if (btn[B_RIGHT]) wx = 1;
  if (wx || wy) { wantX = wx; wantY = wy; }

  float spd = 5.0f + 0.2f * (pacLevel - 1); if (spd > 6.0f) spd = 6.0f;
  float gsp = 3.4f + 0.25f * (pacLevel - 1); if (gsp > 4.8f) gsp = 4.8f;

  // instant reverse
  if ((wantX || wantY) && (pac.dx || pac.dy) && wantX == -pac.dx && wantY == -pac.dy) {
    pac.tx += pac.dx; pac.ty += pac.dy; pac.dx = wantX; pac.dy = wantY; pac.p = 1.0f - pac.p;
  }
  if (pac.dx == 0 && pac.dy == 0) {
    if ((wantX || wantY) && pFree(pac.tx + wantX, pac.ty + wantY)) { pac.dx = wantX; pac.dy = wantY; pac.p = 0; }
  } else {
    pac.p += spd * dt;
    while (pac.p >= 1.0f) {
      pac.p -= 1.0f; pac.tx += pac.dx; pac.ty += pac.dy;
      if (pacEat()) { startLevelUp(SC_PAC_PLAY); return; }
      if ((wantX || wantY) && pFree(pac.tx + wantX, pac.ty + wantY)) { pac.dx = wantX; pac.dy = wantY; }
      else if (!pFree(pac.tx + pac.dx, pac.ty + pac.dy)) { pac.dx = pac.dy = 0; pac.p = 0; break; }
    }
  }
  if (pac.dx || pac.dy) { faceX = pac.dx; faceY = pac.dy; }

  for (int g = 0; g < 2; g++) {
    if (pacT < ghRel[g]) continue;
    bool fr = ghFr[g] && pacT < frightEnd;
    float sp = fr ? 2.8f : gsp;
    Ent& e = gh[g];
    if (e.dx == 0 && e.dy == 0) { ghostChoose(g); e.p = 0; }
    else {
      e.p += sp * dt;
      while (e.p >= 1.0f) {
        e.p -= 1.0f; e.tx += e.dx; e.ty += e.dy; ghostChoose(g);
        if (e.dx == 0 && e.dy == 0) { e.p = 0; break; }
      }
    }
  }

  float px = pac.tx + pac.dx * pac.p, py = pac.ty + pac.dy * pac.p;
  for (int g = 0; g < 2; g++) {
    float gx = gh[g].tx + gh[g].dx * gh[g].p, gy = gh[g].ty + gh[g].dy * gh[g].p;
    if (fabsf(gx - px) + fabsf(gy - py) < 0.7f) {
      if (ghFr[g] && pacT < frightEnd) { pacScore += 200; ghostHome(g); ghRel[g] = pacT + 2000; }
      else {
        if (pacLives <= 1) { pacLives = 0; pacOver(); return; }
        pacLives--; pacResetPos(); freezeUntil = pacT + 1500; return;
      }
    }
  }
}

// ============================== SNAKE =====================================
#define SN_COLS 31
#define SN_ROWS 13
#define SN_X0   2
#define SN_Y0   10
#define SN_MAXLEN (SN_COLS * SN_ROWS)
uint8_t  snX[SN_MAXLEN], snY[SN_MAXLEN]; uint16_t snLen = 4;      // index 0 = head
int8_t   snDx = 1, snDy = 0, snNx = 1, snNy = 0;                   // current and queued direction
uint8_t  foodX = 5, foodY = 5;
uint32_t snScore = 0, snLevel = 0, snAccMs = 0, snEaten = 0, snOverT = 0, snAnim = 0; bool snNewHi = false;

void snPlaceFood() {
  for (int tries = 0; tries < 300; tries++) {
    uint8_t x = random(SN_COLS), y = random(SN_ROWS); bool on = false;
    for (uint16_t i = 0; i < snLen; i++) if (snX[i] == x && snY[i] == y) { on = true; break; }
    if (!on) { foodX = x; foodY = y; return; }
  }
  for (uint8_t y = 0; y < SN_ROWS; y++) for (uint8_t x = 0; x < SN_COLS; x++) {      // board almost full: scan
    bool on = false; for (uint16_t i = 0; i < snLen; i++) if (snX[i] == x && snY[i] == y) { on = true; break; }
    if (!on) { foodX = x; foodY = y; return; }
  }
}
void startSnake() {
  snLen = 4; for (int i = 0; i < 4; i++) { snX[i] = SN_COLS / 2 - i; snY[i] = SN_ROWS / 2; }
  snDx = snNx = 1; snDy = snNy = 0; snScore = 0; snLevel = 0; snEaten = 0; snAccMs = 0; snAnim = 0; snNewHi = false;
  snPlaceFood(); gotoScr(SC_SNAKE_PLAY);
}
void snakeOver() {
  snNewHi = snScore > cfg.shi;
  if (snNewHi) { cfg.shi = snScore; saveShi(); }
  snOverT = millis(); gotoScr(SC_SNAKE_OVER);
}
void snakeInput() {                                    // every loop pass: buttons or stick, no 180-degree turn
  int dx = 0, dy = 0;
  if (btn[B_UP]) dy = -1; else if (btn[B_DOWN]) dy = 1; else if (btn[B_LEFT]) dx = -1; else if (btn[B_RIGHT]) dx = 1;
  else if (fabsf(ax[0]) > 0.5f || fabsf(ax[1]) > 0.5f) { if (fabsf(ax[0]) > fabsf(ax[1])) dx = ax[0] > 0 ? 1 : -1; else dy = ax[1] > 0 ? 1 : -1; }
  if ((dx || dy) && !(dx == -snDx && dy == -snDy)) { snNx = dx; snNy = dy; }
}
void snakeStep(float dt) {
  uint32_t ms = (uint32_t)(dt * 1000.0f + 0.5f); snAccMs += ms; snAnim += ms;
  uint32_t lvl = snLevel > 10 ? 10 : snLevel; uint32_t interval = 170 - 9 * lvl;      // faster every 5 apples
  while (snAccMs >= interval) {
    snAccMs -= interval;
    snDx = snNx; snDy = snNy;
    int nx = snX[0] + snDx, ny = snY[0] + snDy;
    if (nx < 0 || nx >= SN_COLS || ny < 0 || ny >= SN_ROWS) { snakeOver(); return; }
    bool eat = (nx == foodX && ny == foodY);
    uint16_t chk = eat ? snLen : snLen - 1;            // the tail moves away unless we are growing
    for (uint16_t i = 0; i < chk; i++) if (snX[i] == nx && snY[i] == ny) { snakeOver(); return; }
    if (eat && snLen < SN_MAXLEN) snLen++;
    for (int i = snLen - 1; i > 0; i--) { snX[i] = snX[i - 1]; snY[i] = snY[i - 1]; }
    snX[0] = nx; snY[0] = ny;
    if (eat) {
      snScore += 10; snEaten++; snPlaceFood();
      if (snEaten % 5 == 0) { snLevel++; snAccMs = 0; startLevelUp(SC_SNAKE_PLAY); return; }
    }
  }
}
void drawSnakeField() {
  display.drawRect(0, 9, 128, 55, WHITE);
  int fx = SN_X0 + foodX * 4, fy = SN_Y0 + foodY * 4;
  display.drawRect(fx, fy, 4, 4, WHITE);
  if ((snAnim / 250) % 2) display.fillRect(fx + 1, fy + 1, 2, 2, WHITE);
  for (uint16_t i = 0; i < snLen; i++) {
    int x = SN_X0 + snX[i] * 4, y = SN_Y0 + snY[i] * 4;
    if (i == 0) display.fillRect(x, y, 4, 4, WHITE); else display.fillRect(x, y, 3, 3, WHITE);
  }
  display.fillRect(0, 0, 128, 8, BLACK);
  P(0, 0, "HI %05lu", (unsigned long)cfg.shi);
  P(0, 10, "LV%lu", (unsigned long)(snLevel + 1));
  char b[10]; snprintf(b, sizeof b, "%05lu", (unsigned long)snScore); PR(0, b);
}
void drawSnakeScr() {
  if (scr == SC_SNAKE_START) {
    P(0, 0, "HI %05lu", (unsigned long)cfg.shi);
    PCtr(14, "SNAKE", 2); PCtr(36, "PRESS START", 1);
    for (int k = 0; k < 7; k++) display.fillRect(26 + k * 5, 52, k == 6 ? 4 : 3, k == 6 ? 4 : 3, WHITE);
    display.drawRect(76, 52, 4, 4, WHITE); display.fillRect(77, 53, 2, 2, WHITE);
  } else if (scr == SC_SNAKE_PLAY) {
    drawSnakeField();
  } else if (scr == SC_SNAKE_PAUSE) {
    drawSnakeField();
    display.fillRect(20, 20, 88, 34, BLACK); display.drawRect(20, 20, 88, 34, WHITE);
    PCtr(24, "PAUSED", 1); PCtr(35, "START: resume", 1); PCtr(44, "BACK: quit", 1);
  } else {
    PCtr(8, "GAME OVER", 2);
    P(4, 0, "Score  %05lu", (unsigned long)snScore);
    if (snNewHi) P(5, 0, "NEW HI! %05lu", (unsigned long)cfg.shi); else P(5, 0, "HI     %05lu", (unsigned long)cfg.shi);
    P(6, 0, "START: retry"); P(7, 0, "BACK: games");
  }
}

// ============================== DRAWING ===================================
const char* const TGT_LIST[21] = { "None", "A", "B", "X", "Y", "LB", "RB", "LT", "RT", "Select", "Start", "L3", "R3",
                                   "Pad Up", "Pad Down", "Pad Left", "Pad Right", "LS Up", "LS Down", "LS Left", "LS Right" };
const char* const CTL_SHORT[6] = { "Up", "Down", "Left", "Right", "Center", "Click" };

// the five "+" buttons with the game button each one is assigned to; pressed = filled
void drawPlus(int ox, int oy) {
  struct Pt { int x, y; uint8_t ci; };
  const Pt pts[5] = { { 24, 0, B_UP }, { 8, 13, B_LEFT }, { 24, 13, B_CENTER }, { 40, 13, B_RIGHT }, { 24, 26, B_DOWN } };
  for (int k = 0; k < 5; k++) {
    int x = ox + pts[k].x, y = oy + pts[k].y; bool on = btn[pts[k].ci];
    const char* nm = SHORT_TGT[cfg.map[pts[k].ci]];
    if (on) display.fillRect(x, y, 15, 12, WHITE); else display.drawRect(x, y, 15, 12, WHITE);
    display.setTextColor(on ? BLACK : WHITE);
    display.setCursor(x + (15 - (int)strlen(nm) * 6) / 2, y + 2); display.print(nm);
    display.setTextColor(WHITE);
  }
}

void drawMenu() {
  char r[8]; snprintf(r, sizeof r, "%u/5", selMenu + 1);
  header("MAIN MENU", r);
  drawBoxList(MENU_NAMES, 5, selMenu, NULL);
  footer("OK:Open  Left:Back");
}

void drawGames() {
  static char hs[4][12]; static const char* vs[4]; static const char* ns[4];
  uint8_t n = GAME_COUNT > 4 ? 4 : GAME_COUNT;
  for (int i = 0; i < n; i++) { snprintf(hs[i], 12, "HI %lu", (unsigned long)*GAMES[i].hi); vs[i] = hs[i]; ns[i] = GAMES[i].name; }
  char r[8]; snprintf(r, sizeof r, "%u/%u", selGame + 1, n);
  header("GAMES", r);
  drawBoxList(ns, n, selGame, vs);
  footer("Right:Play Left:Menu");
}

void drawSettings() {
  static const char* vs[9];
  for (int i = 0; i < 9; i++) vs[i] = NULL;
  if (!calValid || !oriSet || hiCentre) vs[0] = "!";
  char r[8]; snprintf(r, sizeof r, "%u/9", selSet + 1);
  header("SETTINGS", r);
  drawBoxList(SET_NAMES, 9, selSet, vs);
  footer("Right:Open Left:Back");
}

void drawCalMenu() {
  static const char* vs[3];
  for (int i = 0; i < 3; i++) vs[i] = NULL;
  if (!calValid || hiCentre) vs[0] = "!";
  if (!oriSet) vs[1] = "!";
  char r[8]; snprintf(r, sizeof r, "%u/3", selCal + 1);
  header("CALIBRATION", r);
  drawBoxList(CAL_NAMES, 3, selCal, vs);
  if (hiCentre) footer("Stick on 5V? Use 3V3!"); else footer("Right:Open Left:Back");
}

void drawMapList() {
  static const char* vs[6];
  for (int i = 0; i < 6; i++) vs[i] = TGT_LIST[cfg.map[i]];
  header("ASSIGN BUTTONS", NULL);
  drawBoxList(CTL_SHORT, 6, selMap, vs);
  footer("Right:Edit Left:Back");
}
void drawMapEdit() {
  char t[24]; snprintf(t, sizeof t, "ASSIGN: %s", CTL_SHORT[selMap]);
  header(t, NULL);
  P(2, 0, "This control sends:");
  char b[28]; snprintf(b, sizeof b, "<  %s  >", TGT_NAME[mapTmp]); PCtr(34, b, 1);
  char c[16]; snprintf(c, sizeof c, "%u of 21", mapTmp + 1); PCtr(46, c, 1);
  footer("<>:Pick Ctr:Save");
}

void drawPadMode() {
  static const char* vs[3]; static const char* const ns[3] = { "Mode", "Layout", "Stick Y" };
  vs[0] = PAD_NAME[cfg.pad]; vs[1] = PRESET_NAME[presetIndex()]; vs[2] = cfg.yinv ? "Inverted" : "Normal";
  header("GAMEPAD", NULL);
  drawBoxList(ns, 3, padRow, vs);
  footer(padRow == 0 ? PAD_HINT[cfg.pad] : "<>:Change  Ctr:Save");
}

void drawSystem() {
  header("SYSTEM", NULL);
  drawBoxList(SYS_NAMES, 3, selSys, NULL);
  footer("Right:Open Left:Back");
}

// ---- Bluetooth / USB ----
void drawLinkBody() {
  drawPlus(0, 17);
  drawStickBox(100, 17, ax[0], ax[1], 28);
  display.setCursor(100, 47); display.printf("%-2s %c", SHORT_TGT[cfg.map[5]], btn[5] ? '#' : '.');
  display.setCursor(62, 19); display.print("TX");
  display.setCursor(62, 28); display.printf("%05lu", (unsigned long)(txCount % 100000UL));
  if (since(millis(), lastTxVis) < 120) display.fillRect(62, 40, 6, 6, WHITE);     // blinks on every packet sent
}
void drawHome(bool bt) {
  char tag[10]; snprintf(tag, sizeof tag, "[%s]", bt ? PAD_TAG[cfg.pad] : "USB");
  header(bt ? "BLUETOOTH" : "USB MODE", tag);
  if (bt && btState != BT_CONN) {
    P(1, 0, "Status: Waiting for"); P(2, 0, "        connection...");
    if (xboxMode()) P(4, 0, "Shows as an Xbox pad"); else P(4, 0, "Name: %s", DEV_NAME);
    P(5, 0, "Pair it in the Bluetooth"); P(6, 0, "settings of your host");
    int d = (millis() / 400) % 4; display.setCursor(12 * 6, 16); for (int i = 0; i < d; i++) display.print(". ");
    footer("Hold Center: menu");
    return;
  }
  if (bt) P(1, 0, "Status: CONNECTED");
  else    P(1, 0, "Host: %s", usbConn ? "CONNECTED" : "waiting...");
  drawLinkBody();
  footer("Hold Center: menu");
}

void drawLinkTest() {
  header("LINK TEST", linkMode == LINK_BT ? "[BT]" : (linkMode == LINK_USB ? "[USB]" : NULL));
  if (linkMode == LINK_NONE) {
    P(2, 0, "Open Bluetooth or USB"); P(3, 0, "from the main menu"); P(4, 0, "first."); footer("Center: back"); return;
  }
  if (linkMode == LINK_BT && btState != BT_CONN) {
    P(2, 0, "Bluetooth not"); P(3, 0, "connected yet."); P(4, 0, "Pair, then retry."); footer("Center: back"); return;
  }
  int qx, qy, sem; uint32_t m; testState(millis() - testT0, qx, qy, m, sem);
  P(1, 0, "Sending test pattern");
  drawStickBox(100, 17, qx / 63.0f, qy / 63.0f, 28);
  display.setCursor(6, 22); display.print("Now sending:");
  const char* nm = sem ? TGT_NAME[sem] : "(pause)";
  int len = strlen(nm), sz = len <= 5 ? 2 : 1;
  display.setTextSize(sz); display.setCursor(6, sz == 2 ? 34 : 38); display.print(nm); display.setTextSize(1);
  display.setCursor(0, 56); display.printf("TX%05lu  Center:stop", (unsigned long)(txCount % 100000UL));
  if (since(millis(), lastTxVis) < 120) display.fillRect(122, 58, 5, 5, WHITE);
}

// ---- calibration / orientation / button positions ----
void drawCal() {
  header("CALIBRATE RANGE", NULL);
  drawStickBox(84, 10, logAxis(tcal, 0), logAxis(tcal, 1), 40);
  display.setCursor(0, 11); display.print("Sweep the");
  display.setCursor(0, 19); display.print("stick to all");
  display.setCursor(0, 27); display.print("four edges");
  display.setCursor(0, 37); display.printf("X%3d%% Y%3d%%", calPct(0), calPct(1));
  display.setCursor(0, 46);
  if (hiCentre) display.print("5V? Use 3V3!"); else display.printf("%4d %4d", rawAx[0], rawAx[1]);
  footer(calWarn ? "Low range! Right=save" : "Up:Ctr Dn:Rst Rt:Save");
}

void drawOrient() {
  char r[8]; snprintf(r, sizeof r, "%u/4", oStep < 4 ? oStep + 1 : 4);
  header("ORIENTATION", r);
  if (oStep >= 4) {
    P(1, 0, "Result:"); PR(1, oPass ? "SAVED" : "FAIL");
    if (oPass) {
      P(3, 0, "X: GPIO%u %s", (unsigned)ADC_PIN[ori.src[0]], ori.sgn[0] > 0 ? "normal" : "reversed");
      P(4, 0, "Y: GPIO%u %s", (unsigned)ADC_PIN[ori.src[1]], ori.sgn[1] > 0 ? "normal" : "reversed");
      P(5, 0, "Up and right are set.");
    } else { P(3, 0, "%s", oMsg); P(5, 0, "Push each way cleanly."); }
    footer(oPass ? "Click:Done" : "Click:Retry Ctr:Back");
    return;
  }
  display.setTextSize(2); display.setCursor(4, 14); display.print("Push");
  display.setCursor(4, 32); display.print(O_DIR[oStep]);
  display.setTextSize(1);
  display.setCursor(4, 50);
  display.print(oPhase == 0 ? "Let go of the stick" : (oPhase == 1 ? "Push it now..." : "Got it!"));
  switch (oStep) {                                                      // arrow
    case 0: display.fillTriangle(104, 14, 94, 28, 114, 28, WHITE);  display.fillRect(101, 28, 7, 12, WHITE); break;
    case 1: display.fillTriangle(104, 44, 94, 30, 114, 30, WHITE);  display.fillRect(101, 18, 7, 12, WHITE); break;
    case 2: display.fillTriangle(90, 29, 102, 19, 102, 39, WHITE);  display.fillRect(102, 26, 14, 7, WHITE); break;
    default: display.fillTriangle(118, 29, 106, 19, 106, 39, WHITE); display.fillRect(92, 26, 14, 7, WHITE); break;
  }
  footer("Center:Cancel");
}

void drawPos() {
  if (posDone) {
    header("BUTTON POSITIONS", "DONE");
    P(1, 0, "Up:%u  Down:%u", (unsigned)posPin[0], (unsigned)posPin[1]);
    P(2, 0, "Left:%u  Right:%u", (unsigned)posPin[2], (unsigned)posPin[3]);
    P(3, 0, "Center:%u", (unsigned)posPin[4]);
    P(5, 0, "Press any + button to");
    P(6, 0, "save. Click = cancel.");
    return;
  }
  char r[8]; snprintf(r, sizeof r, "%u/5", posStep + 1);
  header("BUTTON POSITIONS", r);
  display.setCursor(0, 12); display.print("Press this button:");
  display.setTextSize(2); display.setCursor((128 - (int)strlen(POS_NAME[posStep]) * 12) / 2, 26); display.print(POS_NAME[posStep]); display.setTextSize(1);
  display.setCursor(0, 46);
  if (posPhase == 0) display.print("Let go of all buttons");
  else if (posPhase == 1) display.print("Waiting for a press...");
  else if (posPhase == 2) display.printf("Found GPIO%u", (unsigned)posPin[posStep]);
  else display.print("Let go of it...");
  footer("Hold click 2s: cancel");
}

void drawMonitor() {
  header("INPUT MONITOR", NULL);
  drawPlus(0, 10);
  drawStickBox(96, 10, ax[0], ax[1], 30);
  display.setCursor(96, 42); display.printf("Click %c", btn[5] ? '#' : '.');
  display.setCursor(0, 48); display.printf("X%4d Y%4d", rawAx[0], rawAx[1]);
  footer("Center: back");
}

void drawAbout() {
  header("ABOUT", NULL);
  P(1, 0, "ESP32 Controller %s", FW_VERSION);
  P(2, 0, "Chip   %s", ESP.getChipModel());
  P(3, 0, "Heap   %lu KB free", (unsigned long)(ESP.getFreeHeap() / 1024));
  uint32_t s = millis() / 1000;
  P(4, 0, "Uptime %02lu:%02lu:%02lu", (unsigned long)(s / 3600), (unsigned long)((s / 60) % 60), (unsigned long)(s % 60));
  P(5, 0, "Developer:"); P(6, 0, "HARRISH YESURAJ P");
  footer("Center: menu");
}

void drawConfirm() {
  static const char* const CT[5] = { "", "RESET CALIBRATION", "RESET MAPPING", "RESET HIGH SCORES", "FACTORY RESET" };
  static const char* const CA[5] = { "", "Forget calibration", "Restore default", "Reset best scores", "Erase ALL settings" };
  static const char* const CB[5] = { "", "and orientation?", "button mapping?", "to zero?", "and restart?" };
  header(CT[confKind], NULL);
  P(2, 0, "%s", CA[confKind]); P(3, 0, "%s", CB[confKind]);
  item(5, "No", NULL, selConf == 0); item(6, "Yes", NULL, selConf == 1);
  if (confKind == 4 && selConf == 1) {
    footer("Hold click 2 s");
    if (okHoldT) { int w = constrain((int)((millis() - okHoldT) * 40 / 2000), 0, 40); display.drawRect(80, 56, 42, 8, WHITE); display.fillRect(81, 57, w, 6, WHITE); }
  } else footer("Right:Select Left:No");
}

void drawLoading(uint32_t now) {
  uint32_t i = since(now, loadT0) / LOAD_FRAME_MS; if (i >= LOAD_FRAME_COUNT) i = LOAD_FRAME_COUNT - 1;
  display.drawBitmap(0, 0, (const uint8_t*)pgm_read_ptr(&LD_FRAMES[i]), 128, 64, SSD1306_WHITE);
}
void drawLevelUp(uint32_t now) {
  uint32_t i = since(now, lvT0) / LEVELUP_FRAME_MS; if (i >= LEVELUP_FRAMES) i = LEVELUP_FRAMES - 1;
  display.drawBitmap(0, 0, (const uint8_t*)pgm_read_ptr(&LVL_FRAMES[i]), 128, 64, SSD1306_WHITE);
}

void drawField() {
  display.drawFastHLine(0, GROUND_Y, 128, WHITE);
  for (int i = 0; i < 6; i++) display.drawPixel((i * 23) % 128, GROUND_Y + 2 + (i % 2), WHITE);
  for (auto& o : obs) if (o.on) {
    int x = (int)o.x;
    if (o.type == 0) drawCactus(x, 6, 12);
    else if (o.type == 1) drawCactus(x, 10, 16);
    else if (o.type == 2) { drawCactus(x, 6, 12); drawCactus(x + 9, 6, 12); }
    else drawBird(x, BIRD_BOT);
  }
  drawDino(DINO_X, GROUND_Y - (int)dinoH, ducking, dinoH <= 0.01f && scr == SC_DINO_PLAY);
  P(0, 0, "HI %05lu", (unsigned long)cfg.hi);
  P(0, 10, "LV%lu", (unsigned long)(dinoLevel + 1));
  char b[12]; snprintf(b, sizeof b, "%lum", (unsigned long)score); PR(0, b);
}

void drawDinoScr() {
  if (scr == SC_DINO_START) {
    P(0, 0, "HI %05lu m", (unsigned long)cfg.hi);
    PCtr(14, "DINO RUN", 2); PCtr(36, "PRESS START", 1);
    for (auto& o : obs) o.on = false;
    display.drawFastHLine(0, GROUND_Y, 128, WHITE);
    drawDino(DINO_X, GROUND_Y, false, false);
    drawCactus(70, 6, 12); drawBird(100, 11);
  } else if (scr == SC_DINO_PLAY) {
    drawField();
  } else if (scr == SC_DINO_PAUSE) {
    drawField();
    display.fillRect(20, 14, 88, 34, BLACK); display.drawRect(20, 14, 88, 34, WHITE);
    PCtr(18, "PAUSED", 1); PCtr(30, "START: resume", 1); PCtr(39, "BACK: quit", 1);
  } else {
    PCtr(8, "GAME OVER", 2);
    P(4, 0, "Distance %lu m", (unsigned long)score);
    if (newHi) P(5, 0, "NEW HI! %lu m", (unsigned long)cfg.hi); else P(5, 0, "HI  %lu m", (unsigned long)cfg.hi);
    P(6, 0, "START: retry"); P(7, 0, "BACK: games");
  }
}

void drawGhost(int g) {
  Ent& e = gh[g];
  int x0 = PAC_OX + (int)((e.tx + e.dx * e.p) * PT), y0 = PAC_OY + (int)((e.ty + e.dy * e.p) * PT);
  bool fr = ghFr[g] && pacT < frightEnd;
  bool flash = fr && (frightEnd - pacT) < 1500 && ((pacT / 150) % 2);
  if (fr && !flash) {
    display.drawRect(x0, y0 + 1, 6, 5, WHITE);
    display.drawPixel(x0 + 1, y0 + 3, WHITE); display.drawPixel(x0 + 4, y0 + 3, WHITE);
  } else {
    display.fillRect(x0 + 1, y0, 4, 1, WHITE); display.fillRect(x0, y0 + 1, 6, 5, WHITE);
    display.drawPixel(x0 + 1, y0 + 5, BLACK); display.drawPixel(x0 + 4, y0 + 5, BLACK);
    display.drawPixel(x0 + 1 + (e.dx > 0), y0 + 2, BLACK); display.drawPixel(x0 + 3 + (e.dx > 0), y0 + 2, BLACK);
  }
}
void drawPacman(int cx, int cy, int fx, int fy, bool mouth) {
  display.fillCircle(cx, cy, 2, WHITE);
  if (mouth) {
    display.drawLine(cx, cy, cx + fx * 3, cy + fy * 3, BLACK);
    display.drawPixel(cx + fx * 2 + fy, cy + fy * 2 + fx, BLACK);
    display.drawPixel(cx + fx * 2 - fy, cy + fy * 2 - fx, BLACK);
  }
}
void drawPacField() {
  for (int y = 0; y < PAC_H; y++) for (int x = 0; x < PAC_W; x++) {
    int px = PAC_OX + x * PT, py = PAC_OY + y * PT; uint8_t v = pacCell[y][x];
    if (v == 9) {
      display.fillRect(px + 2, py + 2, 2, 2, WHITE);
      if (x + 1 < PAC_W && pacCell[y][x + 1] == 9) display.fillRect(px + 2, py + 2, 6, 2, WHITE);
      if (y + 1 < PAC_H && pacCell[y + 1][x] == 9) display.fillRect(px + 2, py + 2, 2, 6, WHITE);
    } else if (v == 1) display.drawPixel(px + 3, py + 3, WHITE);
    else if (v == 2) display.fillCircle(px + 3, py + 3, ((pacT / 200) % 2) ? 2 : 1, WHITE);
  }
  float fx = pac.tx + pac.dx * pac.p, fy = pac.ty + pac.dy * pac.p;
  drawPacman(PAC_OX + (int)(fx * PT) + 3, PAC_OY + (int)(fy * PT) + 3, faceX, faceY, (pacT / 120) % 2);
  drawGhost(0); drawGhost(1);
  P(0, 0, "%05lu", (unsigned long)pacScore);
  P(0, 8, "LV%u", pacLevel);
  for (int i = 0; i < pacLives; i++) display.fillCircle(122 - i * 8, 3, 2, WHITE);
}
void drawPacScr() {
  if (scr == SC_PAC_START) {
    P(0, 0, "HI %05lu", (unsigned long)cfg.phi);
    PCtr(14, "PAC-MAN", 2); PCtr(36, "PRESS START", 1);
    drawPacman(30, 54, 1, 0, true);
    for (int i = 0; i < 4; i++) display.drawPixel(42 + i * 8, 54, WHITE);
    display.fillRect(88, 51, 6, 5, WHITE); display.fillRect(89, 50, 4, 1, WHITE);
  } else if (scr == SC_PAC_PLAY) {
    drawPacField();
  } else if (scr == SC_PAC_PAUSE) {
    drawPacField();
    display.fillRect(20, 20, 88, 34, BLACK); display.drawRect(20, 20, 88, 34, WHITE);
    PCtr(24, "PAUSED", 1); PCtr(35, "START: resume", 1); PCtr(44, "BACK: quit", 1);
  } else {
    PCtr(8, "GAME OVER", 2);
    P(4, 0, "Score  %05lu", (unsigned long)pacScore);
    if (pacNewHi) P(5, 0, "NEW HI! %05lu", (unsigned long)cfg.phi); else P(5, 0, "HI     %05lu", (unsigned long)cfg.phi);
    P(6, 0, "START: retry"); P(7, 0, "BACK: exit");
  }
}

void drawDisplay() {
  header("DISPLAY", NULL);
  item(2, "Brightness", NULL, dispRow == 0);
  display.setCursor(8, 28); display.print("<");
  cellBar(18, 28, cfg.bri * 2, 10, 5, 6);
  display.setCursor(84, 28); display.printf("%u", cfg.bri); display.setCursor(116, 28); display.print(">");
  item(5, "Timeout", NULL, dispRow == 1);
  display.setCursor(8, 48); display.print("<");
  cellBar(18, 48, TMO_CELLS[cfg.tmo], 10, 5, 6);
  display.setCursor(84, 48); display.print(TMO_NAME[cfg.tmo]); display.setCursor(116, 48); display.print(">");
  footer("<>:Change BACK:Save");
}

void drawLedScr() {
  header("LED", NULL);
  item(2, "Mode", NULL, true);
  char b[20]; snprintf(b, sizeof b, "< %s >", LED_NAME[cfg.led]);
  display.setTextColor(BLACK); PR(2, b); display.setTextColor(WHITE);
  static const char* const H1[4] = { "LED always off.", "LED always on.", "Blinks while pairing,", "Flashes on every" };
  static const char* const H2[4] = { "", "", "solid when connected.", "button or stick move." };
  P(4, 0, "%s", H1[cfg.led]); P(5, 0, "%s", H2[cfg.led]);
  footer("<>:Change BACK:Save");
}

void render(uint32_t now) {
  display.clearDisplay(); display.setTextColor(WHITE); display.setTextSize(1); display.setTextWrap(false);
  switch (scr) {
    case SC_MENU: drawMenu(); break;
    case SC_GAMES: drawGames(); break;
    case SC_HOME_BT: drawHome(true); break;
    case SC_HOME_USB: drawHome(false); break;
    case SC_LINKTEST: drawLinkTest(); break;
    case SC_SETTINGS: drawSettings(); break;
    case SC_PADMODE: drawPadMode(); break;
    case SC_CALMENU: drawCalMenu(); break;
    case SC_CAL: drawCal(); break;
    case SC_ORIENT: drawOrient(); break;
    case SC_POS: drawPos(); break;
    case SC_MAPLIST: drawMapList(); break;
    case SC_MAPEDIT: drawMapEdit(); break;
    case SC_MONITOR: drawMonitor(); break;
    case SC_DISPLAY: drawDisplay(); break;
    case SC_LED: drawLedScr(); break;
    case SC_SYSTEM: drawSystem(); break;
    case SC_ABOUT: drawAbout(); break;
    case SC_CONFIRM: drawConfirm(); break;
    case SC_LOADING: drawLoading(now); break;
    case SC_LEVELUP: drawLevelUp(now); break;
    case SC_PAC_START: case SC_PAC_PLAY: case SC_PAC_PAUSE: case SC_PAC_OVER: drawPacScr(); break;
    case SC_SNAKE_START: case SC_SNAKE_PLAY: case SC_SNAKE_PAUSE: case SC_SNAKE_OVER: drawSnakeScr(); break;
    default: drawDinoScr(); break;
  }
  // hold-Center progress (Bluetooth / USB screens): replaces the footer
  if (menuHold && !menuFired && linkScreen() && !menuSwallow && since(now, menuT) >= 300) {
    display.fillRect(0, 56, 128, 8, BLACK);
    P(7, 0, "Menu");
    int cells = constrain((int)(since(now, menuT) * 10 / MENU_HOLD_MS), 0, 10);
    cellBar(34, 57, cells, 10, 6, 6);
  }
  display.display();
}

bool dynamicScreen(uint32_t now) {
  switch (scr) {
    case SC_HOME_BT: case SC_HOME_USB: case SC_LINKTEST: case SC_CAL: case SC_ORIENT: case SC_POS: case SC_MONITOR:
    case SC_DINO_PLAY: case SC_PAC_PLAY: case SC_SNAKE_PLAY: case SC_ABOUT: case SC_CONFIRM: case SC_LOADING: case SC_LEVELUP:
      return true;
    default: break;
  }
  return menuHold;
}

// ============================== EVENT HANDLING ============================
void restartNow() {
  savePad();
  display.clearDisplay(); display.setTextColor(WHITE); display.setTextSize(1);
  PCtr(16, "Restarting...", 1); PCtr(32, "Then pair it again", 1); PCtr(42, "in Bluetooth.", 1);
  display.display(); delay(1500); ESP.restart();
}

void doConfirm() {
  if (confKind == 1) { defaultsCal(); defaultsOri(); prefs.remove("cal"); prefs.remove("ori"); calValid = false; oriSet = false; softCentre(true); }
  else if (confKind == 2) { memcpy(cfg.map, DEF_MAP, 6); saveMap(); padChanged(); }
  else if (confKind == 3) { cfg.hi = 0; cfg.phi = 0; cfg.shi = 0; saveHi(); savePhi(); saveShi(); }
  else if (confKind == 4) { prefs.clear(); display.clearDisplay(); display.display(); delay(100); ESP.restart(); }
  gotoScr(confKind == 1 ? SC_CALMENU : SC_SYSTEM);
}

void handleEvent(uint8_t ev, uint32_t now) {
  switch (scr) {
    case SC_MENU:
      if (ev == EV_UP)   selMenu = (selMenu + 4) % 5;
      if (ev == EV_DOWN) selMenu = (selMenu + 1) % 5;
      if (ev == EV_BACK && retScr != SC_MENU) gotoScr(retScr);
      if (ev == EV_OK) {
        switch (selMenu) {
          case 0: openBt(); break;
          case 1: openUsb(); break;
          case 2: gotoScr(SC_GAMES); break;
          case 3: gotoScr(SC_SETTINGS); break;
          default: gotoScr(SC_ABOUT); break;
        }
      }
      break;

    case SC_GAMES:
      if (ev == EV_UP)   selGame = (selGame + GAME_COUNT - 1) % GAME_COUNT;
      if (ev == EV_DOWN) selGame = (selGame + 1) % GAME_COUNT;
      if (ev == EV_BACK) gotoScr(SC_MENU);
      if (ev == EV_OK)   startLoading(GAMES[selGame].startScr);
      break;

    case SC_HOME_BT: case SC_HOME_USB: if (ev == EV_MODE) openMenu(); break;
    case SC_LINKTEST: if (ev == EV_BACK) gotoScr(SC_SETTINGS); break;

    case SC_SETTINGS:
      if (ev == EV_UP)   selSet = (selSet + 8) % 9;
      if (ev == EV_DOWN) selSet = (selSet + 1) % 9;
      if (ev == EV_BACK) gotoScr(SC_MENU);
      if (ev == EV_OK) {
        switch (selSet) {
          case 0: gotoScr(SC_CALMENU); break;
          case 1: padRow = 0; gotoScr(SC_PADMODE); break;
          case 2: gotoScr(SC_MAPLIST); break;
          case 3: posStart(); break;
          case 4: gotoScr(SC_MONITOR); break;
          case 5: gotoScr(SC_DISPLAY); break;
          case 6: gotoScr(SC_LED); break;
          case 7: gotoScr(SC_LINKTEST); break;
          default: gotoScr(SC_SYSTEM); break;
        }
      }
      break;

    case SC_PADMODE:
      if (ev == EV_UP)   padRow = (padRow + 2) % 3;
      if (ev == EV_DOWN) padRow = (padRow + 1) % 3;
      if (ev == EV_LEFT || ev == EV_RIGHT || ev == EV_OK) {
        int d = (ev == EV_LEFT) ? -1 : 1;
        if (padRow == 0) {
          int lo = USE_XINPUT ? 0 : 1; int n = 3 - lo;
          cfg.pad = lo + ((cfg.pad - lo) + n + d) % n; padChanged();
        } else if (padRow == 1) {
          uint8_t cur = presetIndex(); uint8_t nxt = (cur == 3) ? 0 : (d > 0 ? (cur + 1) % 3 : (cur + 2) % 3);
          memcpy(cfg.map, PRESET[nxt], 6); saveMap(); padChanged();
        } else cfg.yinv ^= 1;
      }
      if (ev == EV_BACK) { savePad(); if (padNeedsRestart()) restartNow(); else gotoScr(SC_SETTINGS); }
      break;

    case SC_CALMENU:
      if (ev == EV_UP)   selCal = (selCal + 2) % 3;
      if (ev == EV_DOWN) selCal = (selCal + 1) % 3;
      if (ev == EV_BACK) gotoScr(SC_SETTINGS);
      if (ev == EV_OK) {
        if (selCal == 0) calEnter();
        else if (selCal == 1) oriStart();
        else { confKind = 1; gotoScr(SC_CONFIRM); }
      }
      break;
    case SC_CAL:
      if (ev == EV_UP)   calCentreNow(true);                                          // set centre (stick released), restart range
      if (ev == EV_DOWN) { for (int i = 0; i < 2; i++) tcal.mn[i] = tcal.mx[i] = tcal.ct[i]; calWarn = false; }   // restart range
      if (ev == EV_OK)   calSave();
      if (ev == EV_BACK) calCancel();
      break;
    case SC_ORIENT:
      if (ev == EV_BACK) gotoScr(SC_CALMENU);
      if (ev == EV_OK && oStep >= 4) { if (oPass) gotoScr(SC_CALMENU); else oriStart(); }
      break;
    case SC_POS: break;                                                                // handled in posTick()

    case SC_MAPLIST:
      if (ev == EV_UP)   selMap = (selMap + 5) % 6;
      if (ev == EV_DOWN) selMap = (selMap + 1) % 6;
      if (ev == EV_BACK) gotoScr(SC_SETTINGS);
      if (ev == EV_OK)   { mapTmp = cfg.map[selMap]; gotoScr(SC_MAPEDIT); }
      break;
    case SC_MAPEDIT:
      if (ev == EV_LEFT  || ev == EV_UP)   mapTmp = (mapTmp + 20) % 21;
      if (ev == EV_RIGHT || ev == EV_DOWN) mapTmp = (mapTmp + 1) % 21;
      if (ev == EV_BACK || ev == EV_OK) { cfg.map[selMap] = mapTmp; saveMap(); padChanged(); gotoScr(SC_MAPLIST); }   // Center or click saves
      break;

    case SC_MONITOR: if (ev == EV_BACK) gotoScr(SC_SETTINGS); break;

    case SC_DISPLAY:
      if (ev == EV_UP || ev == EV_DOWN) dispRow ^= 1;
      if (ev == EV_LEFT || ev == EV_RIGHT) {
        int d = (ev == EV_RIGHT) ? 1 : -1;
        if (dispRow == 0) { cfg.bri = constrain((int)cfg.bri + d, 1, 5); applyBrightness(); }
        else cfg.tmo = constrain((int)cfg.tmo + d, 0, 3);
      }
      if (ev == EV_BACK) { saveDisplay(); gotoScr(SC_SETTINGS); }
      break;

    case SC_LED:
      if (ev == EV_LEFT  || ev == EV_UP)   cfg.led = constrain((int)cfg.led - 1, 0, 3);
      if (ev == EV_RIGHT || ev == EV_DOWN) cfg.led = constrain((int)cfg.led + 1, 0, 3);
      if (ev == EV_BACK)  { saveLedCfg(); gotoScr(SC_SETTINGS); }
      break;

    case SC_SYSTEM:
      if (ev == EV_UP)   selSys = (selSys + 2) % 3;
      if (ev == EV_DOWN) selSys = (selSys + 1) % 3;
      if (ev == EV_BACK) gotoScr(SC_SETTINGS);
      if (ev == EV_OK)   { confKind = selSys + 2; gotoScr(SC_CONFIRM); }
      break;
    case SC_ABOUT: if (ev == EV_BACK) gotoScr(SC_MENU); break;
    case SC_CONFIRM:
      if (ev == EV_UP || ev == EV_DOWN) { selConf ^= 1; okHoldT = 0; }
      if (ev == EV_BACK) gotoScr(confKind == 1 ? SC_CALMENU : SC_SYSTEM);
      if (ev == EV_OK) {
        if (selConf == 0) gotoScr(confKind == 1 ? SC_CALMENU : SC_SYSTEM);
        else if (confKind != 4) doConfirm();
      }
      break;

    case SC_LOADING: break;                                      // plays for >= 0.6 s, then the game opens
    case SC_LEVELUP: if (ev == EV_OK) gotoScr(lvReturn); break;  // skip the animation

    case SC_DINO_START:
      if (ev == EV_OK) startGame();
      else if (ev == EV_BACK) gotoScr(SC_GAMES);
      break;
    case SC_DINO_PLAY: if (ev == EV_BACK) gotoScr(SC_DINO_PAUSE); break;
    case SC_DINO_PAUSE:
      if (ev == EV_OK) { lastFrame = now; gotoScr(SC_DINO_PLAY); }
      else if (ev == EV_BACK) gotoScr(SC_GAMES);
      break;
    case SC_DINO_OVER:
      if (ev == EV_OK) startGame();
      else if (ev == EV_BACK) gotoScr(SC_GAMES);
      break;

    case SC_PAC_START:
      if (ev == EV_OK) startPac();
      else if (ev == EV_BACK) gotoScr(SC_GAMES);
      break;
    case SC_PAC_PLAY: if (ev == EV_BACK) gotoScr(SC_PAC_PAUSE); break;
    case SC_PAC_PAUSE:
      if (ev == EV_OK) gotoScr(SC_PAC_PLAY);
      else if (ev == EV_BACK) gotoScr(SC_GAMES);
      break;
    case SC_PAC_OVER:
      if (ev == EV_OK) startPac();
      else if (ev == EV_BACK) gotoScr(SC_GAMES);
      break;

    case SC_SNAKE_START:
      if (ev == EV_OK) startSnake();
      else if (ev == EV_BACK) gotoScr(SC_GAMES);
      break;
    case SC_SNAKE_PLAY: if (ev == EV_BACK) gotoScr(SC_SNAKE_PAUSE); break;
    case SC_SNAKE_PAUSE:
      if (ev == EV_OK) gotoScr(SC_SNAKE_PLAY);
      else if (ev == EV_BACK) gotoScr(SC_GAMES);
      break;
    case SC_SNAKE_OVER:
      if (ev == EV_OK) startSnake();
      else if (ev == EV_BACK) gotoScr(SC_GAMES);
      break;
  }
}

// ============================== LED =======================================
void updateLed(uint32_t now) {
  bool on = false;
  switch (cfg.led) {
    case 0: on = false; break;
    case 1: on = true;  break;
    case 3: on = now < ledActUntil; break;
    default:
      if (linkMode == LINK_BT)       on = (btState == BT_CONN) ? true : ((now / 500) % 2 == 0);
      else if (linkMode == LINK_USB) on = usbConn ? true : ((now / 500) % 2 == 0);
      if (scr == SC_DINO_OVER || scr == SC_PAC_OVER || scr == SC_SNAKE_OVER) {
        uint32_t t = since(now, scr == SC_DINO_OVER ? overT : (scr == SC_PAC_OVER ? pacOverT : snOverT)); on = t < 300 && ((t / 100) % 2 == 0);
      }
  }
  setLed(on);
}

// ============================== BOOT ======================================
void bootWait(uint32_t ms) { uint32_t t = millis(); while (millis() - t < ms) yield(); }

void showLogo() {
  display.clearDisplay();
  display.drawBitmap(0, 0, phy_logo, 128, 64, SSD1306_WHITE);
  display.display();
}

void bootProgress(int pct, const char* st[4]) {
  display.clearDisplay(); display.setTextColor(WHITE); display.setTextSize(1);
  P(0, 0, "ESP32 CONTROLLER %s", FW_VERSION);
  P(2, 0, "Loading...");
  display.drawRect(0, 28, 90, 8, WHITE); display.fillRect(2, 30, (86 * pct) / 100, 4, WHITE);
  display.setCursor(96, 28); display.printf("%3d%%", pct);
  static const char* const N[4] = { "Display", "Settings", "Inputs", "Radio" };
  for (int i = 0; i < 4; i++) {
    char line[24]; int nl = strlen(N[i]), sl = strlen(st[i]);
    int dots = 21 - nl - sl - 2; if (dots < 1) dots = 1;
    int n = snprintf(line, sizeof line, "%s ", N[i]);
    for (int d = 0; d < dots; d++) line[n++] = '.';
    n += snprintf(line + n, sizeof line - n, " %s", st[i]);
    P(4 + i, 0, "%s", line);
  }
  display.display();
}

void bootSequence() {
  bootWait(150);                                           // stage 1: black
  showLogo();                                              // stage 2: logo, contrast fades up
  uint32_t t0 = millis(); uint8_t target = CONTRAST[cfg.bri - 1];
  while (millis() - t0 < 1000) {
    uint32_t e = millis() - t0;
    setContrast(e < 400 ? (uint8_t)(target * e / 400) : target);
    delay(10);
  }
  applyBrightness();
  display.clearDisplay(); display.setTextColor(WHITE);     // stage 3: splash
  PCtr(8, "ESP32", 3); PCtr(34, "GAME CONTROLLER", 1); PCtr(44, "STICK + 5 BUTTONS", 1);
  display.setTextSize(1); display.setCursor(128 - strlen(FW_VERSION) * 6, 56); display.print(FW_VERSION);
  display.display();
  bootWait(1150);
  if (cfg.led != 0) setLed(true);                          // stage 4: loading, real checks
  const char* st[4] = { "..", "..", "..", ".." };
  bootProgress(0, st);
  st[0] = "OK"; bootProgress(25, st); bootWait(350);
  st[1] = "OK"; bootProgress(50, st); bootWait(350);

  bool warn = false; hiCentre = false;
  for (int i = 0; i < 2; i++) {                            // stick: re-centre from the resting value, spot wiring / 5 V problems
    long s = 0; for (int k = 0; k < 32; k++) { s += readAdc(ADC_PIN[i]); delay(1); }
    int avg = s / 32;
    if (avg <= 5 || avg >= 4090) { warn = true; continue; }          // wire off or shorted
    if (avg > 2700) { hiCentre = true; warn = true; }                // centre too high: stick on 5 V?
    if (!calValid) { cal.ct[i] = avg; cal.mn[i] = avg > 1700 ? avg - 1700 : 0; cal.mx[i] = avg < 2395 ? avg + 1700 : 4095; }
    else if (abs(avg - cal.ct[i]) < 800) applyCentreC(cal, i, avg, false);
  }
  for (int i = 0; i < 6; i++) (void)rdBtn(i);
  st[2] = warn ? "WARN" : "OK";
  bootProgress(75, st); bootWait(350);
  st[3] = "OK";                                            // Bluetooth starts when you open it in the menu
  bootProgress(100, st); bootWait(350);
  display.clearDisplay(); display.setTextColor(WHITE);     // stage 5: ready
  P(0, 0, "ESP32 CONTROLLER %s", FW_VERSION);
  PCtr(24, "READY", 2);
  display.drawRect(0, 46, 90, 8, WHITE); display.fillRect(2, 48, 86, 4, WHITE);
  display.setCursor(96, 46); display.print("100%");
  display.display();
  if (cfg.led != 0) { setLed(false); bootWait(200); setLed(true); bootWait(200); }
  else bootWait(400);
}

// ============================== SETUP / LOOP ==============================
void setup() {
  pinMode(PIN_LED, OUTPUT); digitalWrite(PIN_LED, LOW);
  Serial.begin(115200);
  analogReadResolution(12);
  analogSetAttenuation(ADC_11db);

  SPI.begin(OLED_SCK, -1, OLED_MOSI, OLED_CS);
  if (!display.begin(SSD1306_SWITCHCAPVCC)) {
    Serial.println("ERROR: SSD1306 OLED init failed - check SPI wiring (D0=18 D1=23 RES=17 DC=16 CS=5)");
    while (true) { digitalWrite(PIN_LED, !digitalRead(PIN_LED)); delay(100); }   // 5 Hz
  }
  display.clearDisplay(); display.display();
  setContrast(0);
  loadSettings();
  applyPins();
  randomSeed(esp_random());

  bootSequence();

  for (int i = 0; i < 6; i++) btn[i] = rdBtn(i);
  lastAct = lastFrame = millis();
  afterBoot();                                             // main menu
}

uint32_t simAcc = 0, lastSim = 0;

void loop() {
  uint32_t now = millis();

  bool act = readInputs(now);
  genEvents(now);
  updateLink(now);

  if (act) {                                               // a sleeping screen only wakes on the first input
    lastAct = now; ledActUntil = now + 50;
    if (!displayOn) { wakeDisplay(); evn = 0; if (pressEdge[B_CENTER]) menuSwallow = true; }
  }

  for (uint8_t i = 0; i < evn; i++) { handleEvent(evq[i], now); needRedraw = true; }
  now = millis();                                          // fresh time: screens changed above stamp millis()

  if (scr == SC_DINO_PLAY) gameInput();
  if (scr == SC_SNAKE_PLAY) snakeInput();
  if (scr == SC_CAL) calTrack();
  if (scr == SC_ORIENT) oriTick(now);
  if (scr == SC_POS) posTick(now);
  if (scr == SC_LOADING && since(now, loadT0) >= (uint32_t)LOAD_FRAME_MS * LOAD_FRAME_COUNT) gotoScr(loadTarget);
  if (scr == SC_LEVELUP && since(now, lvT0) >= (uint32_t)LEVELUP_FRAME_MS * LEVELUP_FRAMES) gotoScr(lvReturn);
  if (scr == SC_CONFIRM && confKind == 4 && selConf == 1) {          // factory reset: hold the click / Right button 2 s
    if (btn[B_CLICK] || btn[B_RIGHT]) { if (!okHoldT) okHoldT = now; else if (now - okHoldT >= 2000) doConfirm(); }
    else okHoldT = 0;
  }

  sendHost(now);
  updateLed(now);

  bool noSleep = (scr == SC_DINO_PLAY || scr == SC_PAC_PLAY || scr == SC_SNAKE_PLAY || scr == SC_CAL || scr == SC_MONITOR ||
                  scr == SC_LOADING || scr == SC_LEVELUP || scr == SC_LINKTEST || scr == SC_ORIENT || scr == SC_POS);
  if (displayOn && !noSleep && TIMEOUT_MS[cfg.tmo] && since(now, lastAct) > TIMEOUT_MS[cfg.tmo]) sleepDisplay();

  // fixed 10 ms simulation steps for both games (accurate jumps and collisions)
  if (scr == SC_DINO_PLAY || scr == SC_PAC_PLAY || scr == SC_SNAKE_PLAY) {
    uint32_t d = now - lastSim; if (d > 100) d = 100;
    simAcc += d;
    while (simAcc >= 10 && (scr == SC_DINO_PLAY || scr == SC_PAC_PLAY || scr == SC_SNAKE_PLAY)) {
      if (scr == SC_DINO_PLAY) gameStep(0.01f); else if (scr == SC_PAC_PLAY) pacStep(0.01f); else snakeStep(0.01f);
      simAcc -= 10;
    }
  } else simAcc = 0;
  lastSim = now;

  if (now - lastFrame >= FRAME_MS) {
    lastFrame = now;
    if (displayOn && (needRedraw || dynamicScreen(now))) { render(now); needRedraw = false; }
  }
  delay(1);
}
